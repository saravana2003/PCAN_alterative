## CMakeLists.txt
```
# SPDX-License-Identifier: Apache-2.0
#
# Phase 2E: Ethernet static IP + DoIP-style log-retrieval skeleton
# (build-only, no board). Board target: ek_ra8d1. The on-chip Ethernet MAC
# (&eth), MDIO (&mdio) and PHY (ethernet-phy@5) are already status=okay in the
# stock board dts - no overlay needed.

cmake_minimum_required(VERSION 3.28.0)

find_package(Zephyr REQUIRED HINTS $ENV{ZEPHYR_BASE})
project(eth_doip)

target_include_directories(app PRIVATE include)
target_sources(app PRIVATE
  src/main.c
  src/doip.c
  src/doip_server.c
)
```

## prj.conf
```kconfig
# Phase 2E - on-chip Ethernet (static IP) + DoIP skeleton. Symbols checked
# against the workspace.
#
#   CONFIG_ETH_RENESAS_RA  -> drivers/ethernet/Kconfig.renesas_ra. "default y"
#        when &eth (compatible renesas,ra-ethernet) is enabled - it is, in the
#        stock ek_ra8d1.dts, together with &mdio and ethernet-phy@5.
#   CONFIG_NET_CONFIG_SETTINGS + NET_CONFIG_MY_IPV4_* -> subsys/net/lib/config.
#        Applies the static IPv4 address at boot (no DHCP), per the STATE.md
#        decision to use static addressing like real automotive networks.
#   zsock_* socket API from <zephyr/net/socket.h> (no CONFIG_POSIX_API needed).

CONFIG_NETWORKING=y
CONFIG_NET_IPV4=y
CONFIG_NET_IPV6=n
CONFIG_NET_UDP=y
CONFIG_NET_TCP=y
CONFIG_NET_SOCKETS=y
CONFIG_NET_L2_ETHERNET=y
CONFIG_ETH_RENESAS_RA=y

# Static IP (no DHCP). GW/DNS point at a typical bench router; adjust on site.
CONFIG_NET_CONFIG_SETTINGS=y
CONFIG_NET_CONFIG_NEED_IPV4=y
CONFIG_NET_CONFIG_MY_IPV4_ADDR="192.168.1.50"
CONFIG_NET_CONFIG_MY_IPV4_NETMASK="255.255.255.0"
CONFIG_NET_CONFIG_MY_IPV4_GW="192.168.1.1"

# Sockets / contexts (one UDP + one TCP listener + one accepted client).
CONFIG_NET_MAX_CONTEXTS=8
CONFIG_NET_MAX_CONN=8
CONFIG_ZVFS_OPEN_MAX=8

# Packet / buffer pools.
CONFIG_NET_PKT_RX_COUNT=16
CONFIG_NET_PKT_TX_COUNT=16
CONFIG_NET_BUF_RX_COUNT=32
CONFIG_NET_BUF_TX_COUNT=32

# TCP initial sequence number needs an entropy source (board has &trng).
CONFIG_ENTROPY_GENERATOR=y

CONFIG_MAIN_STACK_SIZE=2048

CONFIG_LOG=y
CONFIG_LOG_DEFAULT_LEVEL=3
CONFIG_NET_LOG=y
```

## boards/ek_ra8d1.overlay
```dts
/*
 * App-local devicetree overlay for apps/eth_doip on the EK-RA8D1.
 * Zephyr auto-applies <app>/boards/<board>.overlay by filename.
 *
 * WHY THIS EXISTS - a pin conflict in the stock ek_ra8d1 board files:
 *
 * The stock board uses the "ETHERNET B" RMII pin-mux (board manual Table 24,
 * SW1-5 ON / SW1-4 OFF):
 *     mdio_default : ET0_MDC = P401, ET0_MDIO = P402
 *     ether_default: RMII on P403/P405/P406/P700..P705
 * But it ALSO enables &i3c0, whose i3c0_default group claims:
 *     I3C0_SCL = P400, I3C0_SDA = P401
 * => P401 is requested by BOTH mdio (ET0_MDC) and i3c0 (I3C0_SDA). Zephyr's
 * RA pinctrl writes PFS registers at driver init with no build-time conflict
 * check, so on real hardware whichever driver inits last wins P401 and the
 * other peripheral breaks silently.
 *
 * This project does not use I3C, so disable it to give the MDIO/Ethernet MAC
 * sole ownership of P401. (The camera CEU - which also overlaps the RMII pins -
 * is already status=disabled in the stock dts, so no action needed there.)
 *
 * Physical switches for Ethernet on this board (cannot be verified without
 * hardware): SW1-5 ON (ETH-B), SW1-4 OFF (ETH-A), SW1-3 OFF (camera),
 * SW1-8 OFF (I3C). SW1-7 (SDRAM, ON by default) does NOT conflict with ETH-B.
 */

&i3c0 {
	status = "disabled";
};
```

## src/main.c
```c
/*
 * SPDX-License-Identifier: Apache-2.0
 *
 * Phase 2E demo entry point (build-only, no board, no live network).
 *
 * 1. A transport-free DoIP self-test: routing activation + a UDS
 *    ReadDataByIdentifier, checked end to end against doip.c.
 * 2. Report the statically configured IPv4 address and start the DoIP server
 *    threads. Nothing actually talks to a network in this phase.
 */

#include <errno.h>
#include <string.h>

#include <zephyr/kernel.h>
#include <zephyr/net/net_if.h>
#include <zephyr/sys/byteorder.h>
#include <zephyr/logging/log.h>

#include "doip.h"
#include "doip_server.h"

LOG_MODULE_REGISTER(main, LOG_LEVEL_INF);

static bool doip_selftest(void)
{
	struct doip_conn conn;
	uint8_t msg[128];
	uint8_t resp[256];
	int rc;

	doip_conn_init(&conn);

	/* --- Routing Activation Request (tester SA 0x0E80) --- */
	msg[0] = DOIP_PROTOCOL_VERSION;
	msg[1] = (uint8_t)~DOIP_PROTOCOL_VERSION;
	sys_put_be16(DOIP_PT_ROUTING_ACTIVATION_REQ, &msg[2]);
	sys_put_be32(7, &msg[4]);
	sys_put_be16(0x0E80, &msg[8]);   /* source address */
	msg[10] = 0x00;                  /* activation type: default */
	memset(&msg[11], 0, 4);          /* reserved */

	rc = doip_handle_tcp(&conn, msg, 8 + 7, resp, sizeof(resp));
	if (rc < (int)(DOIP_HEADER_SIZE + 9) ||
	    sys_get_be16(&resp[2]) != DOIP_PT_ROUTING_ACTIVATION_RESP ||
	    resp[8 + 4] != DOIP_RA_CODE_SUCCESS || !conn.routing_active) {
		LOG_ERR("selftest: routing activation failed (rc=%d)", rc);
		return false;
	}

	/* --- Diagnostic Message carrying UDS ReadDataByIdentifier(0xF190) --- */
	sys_put_be16(DOIP_PT_DIAG_MESSAGE, &msg[2]);
	sys_put_be32(4 + 3, &msg[4]);
	sys_put_be16(0x0E80, &msg[8]);                  /* SA */
	sys_put_be16(DOIP_ENTITY_LOGICAL_ADDR, &msg[10]); /* TA */
	msg[12] = UDS_SID_READ_DATA_BY_ID;
	sys_put_be16(0xF190, &msg[13]);

	rc = doip_handle_tcp(&conn, msg, 8 + 4 + 3, resp, sizeof(resp));
	if (rc <= 0) {
		LOG_ERR("selftest: diag message rc=%d", rc);
		return false;
	}

	/* Expect: 0x8002 positive ack, then 0x8001 with UDS 0x62 F1 90 + VIN. */
	if (sys_get_be16(&resp[2]) != DOIP_PT_DIAG_MESSAGE_POS_ACK) {
		LOG_ERR("selftest: missing diag positive ack");
		return false;
	}

	int off = DOIP_HEADER_SIZE + 5; /* header + SA/TA/ackcode */

	if (sys_get_be16(&resp[off + 2]) != DOIP_PT_DIAG_MESSAGE) {
		LOG_ERR("selftest: missing UDS diag message");
		return false;
	}
	const uint8_t *uds = &resp[off + DOIP_HEADER_SIZE + 4];

	if (uds[0] != (UDS_SID_READ_DATA_BY_ID | UDS_POSITIVE_RESPONSE_MASK) ||
	    sys_get_be16(&uds[1]) != 0xF190) {
		LOG_ERR("selftest: bad UDS response 0x%02x", uds[0]);
		return false;
	}

	LOG_INF("selftest PASS (routing activation + UDS RDBI/VIN)");
	return true;
}

static void report_ipv4(void)
{
	struct net_if *iface = net_if_get_default();

	/* The address is applied at boot by CONFIG_NET_CONFIG_SETTINGS from the
	 * CONFIG_NET_CONFIG_MY_IPV4_* values in prj.conf. On real hardware it
	 * only takes effect once the PHY link is up.
	 */
	LOG_INF("configured static IPv4: %s / %s  gw %s",
		CONFIG_NET_CONFIG_MY_IPV4_ADDR,
		CONFIG_NET_CONFIG_MY_IPV4_NETMASK,
		CONFIG_NET_CONFIG_MY_IPV4_GW);

	if (iface == NULL) {
		LOG_WRN("no default network interface");
	} else {
		LOG_INF("default iface %p, up=%d", (void *)iface,
			net_if_is_up(iface));
	}
}

int main(void)
{
	if (!doip_selftest()) {
		LOG_ERR("DoIP self-test FAILED");
		return 0;
	}

	/* Give CONFIG_NET_CONFIG_SETTINGS a moment to configure the iface. */
	k_sleep(K_MSEC(100));
	report_ipv4();

	int ret = doip_server_start();

	if (ret != 0) {
		LOG_ERR("doip_server_start failed: %d", ret);
		return 0;
	}

	LOG_INF("DoIP skeleton up on 192.168.1.50:%d (UDP discovery + TCP diag)",
		DOIP_PORT);
	return 0;
}
```

## include/doip.h
```c
/*
 * SPDX-License-Identifier: Apache-2.0
 *
 * Phase 2E - DoIP (Diagnostics over IP, ISO 13400) message skeleton for
 * retrieving CAN logs from the board over Ethernet.
 *
 * Scope (per PROMPTS.md Phase 2E): a *skeleton*, not a full ISO 13400 stack -
 *   - respond to a Vehicle Identification Request with a Vehicle
 *     Announcement / Identification Response,
 *   - accept a Routing Activation Request and answer with a Routing
 *     Activation Response,
 *   - accept a Diagnostic Message carrying a placeholder UDS "upload" request
 *     (RequestUpload / TransferData / RequestTransferExit) and answer it.
 *
 * This file is transport-independent: it parses and builds byte buffers only,
 * so it is unit-testable without a network (see main.c's self-test). The
 * socket plumbing lives in doip_server.c.
 *
 * DoIP message = 8-byte header + payload:
 *   off 0 : protocol version        u8   (0x02 = ISO 13400-2:2012)
 *   off 1 : inverse protocol version u8  (~version)
 *   off 2 : payload type            u16  big-endian
 *   off 4 : payload length          u32  big-endian
 *   off 8 : payload                 (payload length bytes)
 */

#ifndef ETH_DOIP_DOIP_H_
#define ETH_DOIP_DOIP_H_

#include <stdbool.h>
#include <stddef.h>
#include <stdint.h>

#ifdef __cplusplus
extern "C" {
#endif

#define DOIP_PROTOCOL_VERSION      0x02U   /* ISO 13400-2:2012 */
#define DOIP_INVERSE_VERSION       0xFDU
#define DOIP_PORT                  13400
#define DOIP_HEADER_SIZE           8U

/* Payload types (ISO 13400-2). */
#define DOIP_PT_GENERIC_NACK               0x0000U
#define DOIP_PT_VEHICLE_ID_REQ             0x0001U
#define DOIP_PT_VEHICLE_ID_REQ_EID         0x0002U
#define DOIP_PT_VEHICLE_ID_REQ_VIN         0x0003U
#define DOIP_PT_VEHICLE_ANNOUNCEMENT       0x0004U /* == vehicle id response */
#define DOIP_PT_ROUTING_ACTIVATION_REQ     0x0005U
#define DOIP_PT_ROUTING_ACTIVATION_RESP    0x0006U
#define DOIP_PT_ALIVE_CHECK_REQ            0x0007U
#define DOIP_PT_ALIVE_CHECK_RESP           0x0008U
#define DOIP_PT_DIAG_MESSAGE              0x8001U
#define DOIP_PT_DIAG_MESSAGE_POS_ACK      0x8002U
#define DOIP_PT_DIAG_MESSAGE_NEG_ACK      0x8003U

/* Generic header NACK codes. */
#define DOIP_NACK_INCORRECT_PATTERN        0x00U
#define DOIP_NACK_UNKNOWN_PAYLOAD_TYPE     0x01U
#define DOIP_NACK_MESSAGE_TOO_LARGE        0x02U
#define DOIP_NACK_INVALID_LENGTH           0x04U

/* Routing activation response codes. */
#define DOIP_RA_CODE_SUCCESS               0x10U
#define DOIP_RA_CODE_UNKNOWN_SA            0x00U
#define DOIP_RA_CODE_UNSUPPORTED_TYPE      0x06U

/* Diagnostic message positive/negative ack codes. */
#define DOIP_DIAG_ACK_OK                   0x00U
#define DOIP_DIAG_NACK_UNKNOWN_TA          0x03U

/*
 * Our identity. These are placeholders for the project - a real deployment
 * assigns addresses per the vehicle's DoIP address plan.
 */
#define DOIP_ENTITY_LOGICAL_ADDR   0x1234U  /* this logger, as a DoIP entity   */
#define DOIP_TESTER_ADDR_MIN       0x0E00U  /* accepted external tester range  */
#define DOIP_TESTER_ADDR_MAX       0x0FFFU

/* UDS service IDs used by the placeholder log-download flow. */
#define UDS_SID_READ_DATA_BY_ID    0x22U
#define UDS_SID_REQUEST_UPLOAD     0x35U
#define UDS_SID_TRANSFER_DATA      0x36U
#define UDS_SID_REQUEST_XFER_EXIT  0x37U
#define UDS_POSITIVE_RESPONSE_MASK 0x40U
#define UDS_NRC_SERVICE_NOT_SUPPORTED   0x11U
#define UDS_NRC_REQUEST_OUT_OF_RANGE    0x31U

/** Per-TCP-connection DoIP state. */
struct doip_conn {
	bool     routing_active;
	uint16_t tester_addr;
	uint8_t  block_seq;   /* TransferData block sequence counter */
};

static inline void doip_conn_init(struct doip_conn *c)
{
	c->routing_active = false;
	c->tester_addr = 0;
	c->block_seq = 0;
}

/**
 * @brief Parse and validate a DoIP header.
 *
 * @param buf        message bytes
 * @param len        bytes available
 * @param type[out]  payload type
 * @param plen[out]  payload length from the header
 * @retval 0         header OK (does not check that @p len covers the payload)
 * @retval -EBADMSG  bad protocol version / inverse version
 * @retval -EINVAL   fewer than 8 bytes
 */
int doip_parse_header(const uint8_t *buf, size_t len, uint16_t *type, uint32_t *plen);

/**
 * @brief Handle one DoIP message received over UDP (discovery).
 *
 * Answers Vehicle Identification Requests with a Vehicle Announcement.
 *
 * @return response length written to @p resp, 0 if nothing to send, or <0.
 */
int doip_handle_udp(const uint8_t *msg, size_t len, uint8_t *resp, size_t resp_size);

/**
 * @brief Handle one complete DoIP message received over a TCP connection.
 *
 * Routing activation, alive-check and diagnostic-message (UDS) dispatch.
 * Updates @p conn.
 *
 * @return response length written to @p resp, 0 if nothing to send, or <0.
 */
int doip_handle_tcp(struct doip_conn *conn, const uint8_t *msg, size_t len,
		    uint8_t *resp, size_t resp_size);

#ifdef __cplusplus
}
#endif

#endif /* ETH_DOIP_DOIP_H_ */
```

## include/doip_server.h
```c
/*
 * SPDX-License-Identifier: Apache-2.0
 *
 * Phase 2E - DoIP socket server (UDP discovery on :13400, TCP diagnostics on
 * :13400). Thin transport wrapper around doip.c.
 */

#ifndef ETH_DOIP_DOIP_SERVER_H_
#define ETH_DOIP_DOIP_SERVER_H_

#ifdef __cplusplus
extern "C" {
#endif

/**
 * @brief Start the UDP and TCP DoIP server threads.
 *
 * Safe to call before the network interface is up; the threads block in
 * recvfrom()/accept() until traffic arrives.
 *
 * @retval 0   threads started
 * @retval <0  errno
 */
int doip_server_start(void);

#ifdef __cplusplus
}
#endif

#endif /* ETH_DOIP_DOIP_SERVER_H_ */
```

## src/doip.c
```c
/*
 * SPDX-License-Identifier: Apache-2.0
 *
 * Phase 2E - DoIP message skeleton. Build-only; no board, no live network.
 *
 * Transport-independent: every function here takes and returns byte buffers.
 */

#include <errno.h>
#include <string.h>

#include <zephyr/sys/byteorder.h>
#include <zephyr/logging/log.h>

#include "doip.h"

LOG_MODULE_REGISTER(doip, LOG_LEVEL_INF);

/* Placeholder vehicle identity for the project. */
static const char DOIP_VIN[17] = "EKRA8D1CANLOGGER0";
static const uint8_t DOIP_EID[6] = { 0x74, 0x90, 0x50, 0xB0, 0x5D, 0xE9 }; /* board MAC */
static const uint8_t DOIP_GID[6] = { 0x00, 0x00, 0x00, 0x00, 0x00, 0x01 };

/* Our "log store status" diagnostic data identifier. */
#define UDS_DID_VIN            0xF190U
#define UDS_DID_LOG_STATUS     0xFD00U

/* -------------------------------------------------------------------------- */

int doip_parse_header(const uint8_t *buf, size_t len, uint16_t *type, uint32_t *plen)
{
	if (len < DOIP_HEADER_SIZE) {
		return -EINVAL;
	}
	if (buf[0] != DOIP_PROTOCOL_VERSION ||
	    buf[1] != (uint8_t)~DOIP_PROTOCOL_VERSION) {
		return -EBADMSG;
	}
	*type = sys_get_be16(&buf[2]);
	*plen = sys_get_be32(&buf[4]);
	return 0;
}

static int emit(uint8_t *resp, size_t resp_size, uint16_t type,
		const uint8_t *payload, uint32_t plen)
{
	if (resp_size < DOIP_HEADER_SIZE + plen) {
		return -ENOMEM;
	}
	resp[0] = DOIP_PROTOCOL_VERSION;
	resp[1] = (uint8_t)~DOIP_PROTOCOL_VERSION;
	sys_put_be16(type, &resp[2]);
	sys_put_be32(plen, &resp[4]);
	if (plen > 0U) {
		memcpy(&resp[DOIP_HEADER_SIZE], payload, plen);
	}
	return (int)(DOIP_HEADER_SIZE + plen);
}

static int emit_generic_nack(uint8_t *resp, size_t resp_size, uint8_t code)
{
	return emit(resp, resp_size, DOIP_PT_GENERIC_NACK, &code, 1);
}

static int build_vehicle_announcement(uint8_t *resp, size_t resp_size)
{
	uint8_t p[32];

	memcpy(&p[0], DOIP_VIN, 17);
	sys_put_be16(DOIP_ENTITY_LOGICAL_ADDR, &p[17]);
	memcpy(&p[19], DOIP_EID, 6);
	memcpy(&p[25], DOIP_GID, 6);
	p[31] = 0x00; /* further action required: none */

	return emit(resp, resp_size, DOIP_PT_VEHICLE_ANNOUNCEMENT, p, sizeof(p));
}

/* -------------------------------------------------------------------------- */

int doip_handle_udp(const uint8_t *msg, size_t len, uint8_t *resp, size_t resp_size)
{
	uint16_t type;
	uint32_t plen;
	int rc = doip_parse_header(msg, len, &type, &plen);

	if (rc == -EBADMSG) {
		return emit_generic_nack(resp, resp_size, DOIP_NACK_INCORRECT_PATTERN);
	}
	if (rc < 0) {
		return 0;
	}

	switch (type) {
	case DOIP_PT_VEHICLE_ID_REQ:
	case DOIP_PT_VEHICLE_ID_REQ_EID:
	case DOIP_PT_VEHICLE_ID_REQ_VIN:
		LOG_INF("UDP: vehicle identification request -> announcement");
		return build_vehicle_announcement(resp, resp_size);
	default:
		return emit_generic_nack(resp, resp_size,
					 DOIP_NACK_UNKNOWN_PAYLOAD_TYPE);
	}
}

/* -------------------------------------------------------------------------- */
/* UDS placeholder - the "data download" flow for pulling logs off the board. */
/* -------------------------------------------------------------------------- */

static uint16_t uds_nrc(uint8_t sid, uint8_t nrc, uint8_t *out)
{
	out[0] = 0x7F;
	out[1] = sid;
	out[2] = nrc;
	return 3;
}

static uint16_t uds_dispatch(struct doip_conn *conn, const uint8_t *uds, size_t n,
			     uint8_t *out, size_t out_size)
{
	if (n == 0U || out_size < 8U) {
		return 0;
	}

	switch (uds[0]) {
	case UDS_SID_READ_DATA_BY_ID: {
		if (n < 3U) {
			return uds_nrc(uds[0], UDS_NRC_REQUEST_OUT_OF_RANGE, out);
		}
		uint16_t did = sys_get_be16(&uds[1]);

		out[0] = UDS_SID_READ_DATA_BY_ID | UDS_POSITIVE_RESPONSE_MASK;
		sys_put_be16(did, &out[1]);

		if (did == UDS_DID_VIN) {
			memcpy(&out[3], DOIP_VIN, 17);
			return 3 + 17;
		}
		if (did == UDS_DID_LOG_STATUS) {
			/* Placeholder: [num_files u16][total_bytes u32]. A real
			 * build queries the Phase 2D littlefs store.
			 */
			sys_put_be16(0, &out[3]);
			sys_put_be32(0, &out[5]);
			return 3 + 6;
		}
		return uds_nrc(uds[0], UDS_NRC_REQUEST_OUT_OF_RANGE, out);
	}

	case UDS_SID_REQUEST_UPLOAD:
		/* 0x35 + dataFormatId + addrAndLenFormatId + addr + size.
		 * Response: 0x75 + lengthFormatId(0x20) + maxNumberOfBlockLength.
		 */
		out[0] = UDS_SID_REQUEST_UPLOAD | UDS_POSITIVE_RESPONSE_MASK;
		out[1] = 0x20;                    /* 2-byte maxNumberOfBlockLength */
		sys_put_be16(1024, &out[2]);
		conn->block_seq = 0;
		return 4;

	case UDS_SID_TRANSFER_DATA: {
		if (n < 2U) {
			return uds_nrc(uds[0], UDS_NRC_REQUEST_OUT_OF_RANGE, out);
		}
		uint8_t seq = uds[1];

		conn->block_seq = seq;
		out[0] = UDS_SID_TRANSFER_DATA | UDS_POSITIVE_RESPONSE_MASK;
		out[1] = seq;
		/* Placeholder log chunk. A real build returns the next slice of
		 * the requested /lfs/log_*.clb file here.
		 */
		memset(&out[2], 0xAA, 8);
		return 10;
	}

	case UDS_SID_REQUEST_XFER_EXIT:
		out[0] = UDS_SID_REQUEST_XFER_EXIT | UDS_POSITIVE_RESPONSE_MASK;
		return 1;

	default:
		return uds_nrc(uds[0], UDS_NRC_SERVICE_NOT_SUPPORTED, out);
	}
}

/* -------------------------------------------------------------------------- */

static int handle_routing_activation(struct doip_conn *conn, const uint8_t *pl,
				     uint32_t plen, uint8_t *resp, size_t resp_size)
{
	uint8_t rp[9];
	uint16_t sa;
	uint8_t code;

	if (plen < 7U) {
		return emit_generic_nack(resp, resp_size, DOIP_NACK_INVALID_LENGTH);
	}

	sa = sys_get_be16(&pl[0]);
	if (sa >= DOIP_TESTER_ADDR_MIN && sa <= DOIP_TESTER_ADDR_MAX) {
		conn->routing_active = true;
		conn->tester_addr = sa;
		code = DOIP_RA_CODE_SUCCESS;
		LOG_INF("TCP: routing activation from tester 0x%04x -> success", sa);
	} else {
		code = DOIP_RA_CODE_UNKNOWN_SA;
		LOG_WRN("TCP: routing activation from unknown SA 0x%04x", sa);
	}

	sys_put_be16(sa, &rp[0]);                       /* logical addr tester   */
	sys_put_be16(DOIP_ENTITY_LOGICAL_ADDR, &rp[2]); /* logical addr entity   */
	rp[4] = code;
	memset(&rp[5], 0, 4);                           /* reserved              */

	return emit(resp, resp_size, DOIP_PT_ROUTING_ACTIVATION_RESP,
		    rp, sizeof(rp));
}

static int handle_diag_message(struct doip_conn *conn, const uint8_t *pl,
			       uint32_t plen, uint8_t *resp, size_t resp_size)
{
	uint8_t ack[5];
	uint16_t sa, ta;
	int off = 0;
	int rc;

	if (plen < 4U) {
		return emit_generic_nack(resp, resp_size, DOIP_NACK_INVALID_LENGTH);
	}

	sa = sys_get_be16(&pl[0]);
	ta = sys_get_be16(&pl[2]);

	if (!conn->routing_active) {
		sys_put_be16(ta, &ack[0]);
		sys_put_be16(sa, &ack[2]);
		ack[4] = 0x06; /* out of memory / not activated */
		return emit(resp, resp_size, DOIP_PT_DIAG_MESSAGE_NEG_ACK,
			    ack, sizeof(ack));
	}
	if (ta != DOIP_ENTITY_LOGICAL_ADDR) {
		sys_put_be16(ta, &ack[0]);
		sys_put_be16(sa, &ack[2]);
		ack[4] = DOIP_DIAG_NACK_UNKNOWN_TA;
		return emit(resp, resp_size, DOIP_PT_DIAG_MESSAGE_NEG_ACK,
			    ack, sizeof(ack));
	}

	/* 1) Diagnostic message positive acknowledge (SA/TA swapped). */
	sys_put_be16(DOIP_ENTITY_LOGICAL_ADDR, &ack[0]);
	sys_put_be16(sa, &ack[2]);
	ack[4] = DOIP_DIAG_ACK_OK;
	rc = emit(resp, resp_size, DOIP_PT_DIAG_MESSAGE_POS_ACK, ack, sizeof(ack));
	if (rc < 0) {
		return rc;
	}
	off = rc;

	/* 2) The UDS response, carried in its own diagnostic message. */
	{
		uint8_t dm[4 + 64];
		uint16_t uds_len;

		sys_put_be16(DOIP_ENTITY_LOGICAL_ADDR, &dm[0]);
		sys_put_be16(sa, &dm[2]);
		uds_len = uds_dispatch(conn, &pl[4], plen - 4U, &dm[4],
				       sizeof(dm) - 4U);
		if (uds_len == 0U) {
			return off;
		}

		rc = emit(resp + off, resp_size - off, DOIP_PT_DIAG_MESSAGE,
			  dm, 4U + uds_len);
		if (rc < 0) {
			return rc;
		}
		off += rc;
	}

	return off;
}

int doip_handle_tcp(struct doip_conn *conn, const uint8_t *msg, size_t len,
		    uint8_t *resp, size_t resp_size)
{
	uint16_t type;
	uint32_t plen;
	const uint8_t *pl;
	int rc = doip_parse_header(msg, len, &type, &plen);

	if (rc == -EBADMSG) {
		return emit_generic_nack(resp, resp_size, DOIP_NACK_INCORRECT_PATTERN);
	}
	if (rc < 0) {
		return 0;
	}
	if (len < (size_t)DOIP_HEADER_SIZE + plen) {
		return emit_generic_nack(resp, resp_size, DOIP_NACK_INVALID_LENGTH);
	}
	pl = &msg[DOIP_HEADER_SIZE];

	switch (type) {
	case DOIP_PT_ROUTING_ACTIVATION_REQ:
		return handle_routing_activation(conn, pl, plen, resp, resp_size);

	case DOIP_PT_ALIVE_CHECK_REQ: {
		uint8_t ap[2];

		sys_put_be16(DOIP_ENTITY_LOGICAL_ADDR, ap);
		return emit(resp, resp_size, DOIP_PT_ALIVE_CHECK_RESP, ap, sizeof(ap));
	}

	case DOIP_PT_DIAG_MESSAGE:
		return handle_diag_message(conn, pl, plen, resp, resp_size);

	default:
		return emit_generic_nack(resp, resp_size,
					 DOIP_NACK_UNKNOWN_PAYLOAD_TYPE);
	}
}
```

## src/doip_server.c
```c
/*
 * SPDX-License-Identifier: Apache-2.0
 *
 * Phase 2E - DoIP socket server. Build-only; no board, no live network.
 */

#include <errno.h>
#include <string.h>

#include <zephyr/kernel.h>
#include <zephyr/net/socket.h>
#include <zephyr/sys/byteorder.h>
#include <zephyr/logging/log.h>

#include "doip.h"
#include "doip_server.h"

LOG_MODULE_REGISTER(doip_server, LOG_LEVEL_INF);

#define STACK_SIZE 3072
#define MSG_BUF    600   /* one DoIP message (header + bounded payload) */
#define RESP_BUF   600

K_THREAD_STACK_DEFINE(udp_stack, STACK_SIZE);
K_THREAD_STACK_DEFINE(tcp_stack, STACK_SIZE);
static struct k_thread udp_thread;
static struct k_thread tcp_thread;

/* -------------------------------------------------------------------------- */

static int recv_full(int fd, uint8_t *buf, size_t need)
{
	size_t got = 0;

	while (got < need) {
		ssize_t n = zsock_recv(fd, &buf[got], need - got, 0);

		if (n == 0) {
			return 0;              /* peer closed */
		}
		if (n < 0) {
			return -errno;
		}
		got += (size_t)n;
	}
	return (int)got;
}

static void handle_tcp_client(int fd)
{
	struct doip_conn conn;
	uint8_t msg[MSG_BUF];
	uint8_t resp[RESP_BUF];

	doip_conn_init(&conn);

	for (;;) {
		uint32_t plen;
		int rc = recv_full(fd, msg, DOIP_HEADER_SIZE);

		if (rc <= 0) {
			break;
		}

		plen = sys_get_be32(&msg[4]);
		if (plen > (uint32_t)(sizeof(msg) - DOIP_HEADER_SIZE)) {
			LOG_WRN("TCP: payload too large (%u) - dropping client", plen);
			break;
		}

		if (plen > 0U) {
			rc = recv_full(fd, &msg[DOIP_HEADER_SIZE], plen);
			if (rc <= 0) {
				break;
			}
		}

		rc = doip_handle_tcp(&conn, msg, DOIP_HEADER_SIZE + plen,
				     resp, sizeof(resp));
		if (rc > 0) {
			(void)zsock_send(fd, resp, (size_t)rc, 0);
		}
	}

	zsock_close(fd);
	LOG_INF("TCP: client disconnected");
}

static void tcp_thread_fn(void *a, void *b, void *c)
{
	ARG_UNUSED(a); ARG_UNUSED(b); ARG_UNUSED(c);

	int srv = zsock_socket(AF_INET, SOCK_STREAM, IPPROTO_TCP);
	struct sockaddr_in addr = {
		.sin_family = AF_INET,
		.sin_port = htons(DOIP_PORT),
		.sin_addr.s_addr = htonl(INADDR_ANY),
	};

	if (srv < 0) {
		LOG_ERR("TCP: socket() failed: %d", -errno);
		return;
	}
	if (zsock_bind(srv, (struct sockaddr *)&addr, sizeof(addr)) < 0) {
		LOG_ERR("TCP: bind() failed: %d", -errno);
		zsock_close(srv);
		return;
	}
	if (zsock_listen(srv, 1) < 0) {
		LOG_ERR("TCP: listen() failed: %d", -errno);
		zsock_close(srv);
		return;
	}

	LOG_INF("DoIP TCP server on :%d", DOIP_PORT);

	for (;;) {
		struct sockaddr_in peer;
		socklen_t plen = sizeof(peer);
		int fd = zsock_accept(srv, (struct sockaddr *)&peer, &plen);

		if (fd < 0) {
			LOG_ERR("TCP: accept() failed: %d", -errno);
			k_sleep(K_MSEC(200));
			continue;
		}
		LOG_INF("TCP: client connected");
		handle_tcp_client(fd);
	}
}

static void udp_thread_fn(void *a, void *b, void *c)
{
	ARG_UNUSED(a); ARG_UNUSED(b); ARG_UNUSED(c);

	int fd = zsock_socket(AF_INET, SOCK_DGRAM, IPPROTO_UDP);
	struct sockaddr_in addr = {
		.sin_family = AF_INET,
		.sin_port = htons(DOIP_PORT),
		.sin_addr.s_addr = htonl(INADDR_ANY),
	};
	uint8_t msg[MSG_BUF];
	uint8_t resp[RESP_BUF];

	if (fd < 0) {
		LOG_ERR("UDP: socket() failed: %d", -errno);
		return;
	}
	if (zsock_bind(fd, (struct sockaddr *)&addr, sizeof(addr)) < 0) {
		LOG_ERR("UDP: bind() failed: %d", -errno);
		zsock_close(fd);
		return;
	}

	LOG_INF("DoIP UDP discovery on :%d", DOIP_PORT);

	for (;;) {
		struct sockaddr_in peer;
		socklen_t peerlen = sizeof(peer);
		ssize_t n = zsock_recvfrom(fd, msg, sizeof(msg), 0,
					   (struct sockaddr *)&peer, &peerlen);
		int rc;

		if (n < 0) {
			LOG_ERR("UDP: recvfrom() failed: %d", -errno);
			k_sleep(K_MSEC(200));
			continue;
		}

		rc = doip_handle_udp(msg, (size_t)n, resp, sizeof(resp));
		if (rc > 0) {
			(void)zsock_sendto(fd, resp, (size_t)rc, 0,
					   (struct sockaddr *)&peer, peerlen);
		}
	}
}

int doip_server_start(void)
{
	k_thread_create(&udp_thread, udp_stack, STACK_SIZE, udp_thread_fn,
			NULL, NULL, NULL, K_PRIO_PREEMPT(8), 0, K_NO_WAIT);
	k_thread_name_set(&udp_thread, "doip_udp");

	k_thread_create(&tcp_thread, tcp_stack, STACK_SIZE, tcp_thread_fn,
			NULL, NULL, NULL, K_PRIO_PREEMPT(8), 0, K_NO_WAIT);
	k_thread_name_set(&tcp_thread, "doip_tcp");

	return 0;
}
```
