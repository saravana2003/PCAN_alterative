## CMakeLists.txt
```
# SPDX-License-Identifier: Apache-2.0
#
# Phase 2B: GPIO buttons/LEDs + periodic timer module (build-only, no board).
# Board target: ek_ra8d1. Uses only stock ek_ra8d1.dts nodes (gpio-keys,
# gpio-leds, port_irq12/13) - no devicetree overlay required.

cmake_minimum_required(VERSION 3.28.0)

find_package(Zephyr REQUIRED HINTS $ENV{ZEPHYR_BASE})
project(gpio_timer)

target_include_directories(app PRIVATE include)
target_sources(app PRIVATE
  src/main.c
  src/io_control.c
  src/log_timer.c
)
```

## prj.conf
```kconfig
# Phase 2B - GPIO buttons/LEDs + periodic timer. Each symbol checked against
# the workspace before being added:
#   CONFIG_GPIO                        -> drivers/gpio/Kconfig (also already y in
#                                        boards/renesas/ek_ra8d1/ek_ra8d1_defconfig)
#   CONFIG_RENESAS_RA_EXTERNAL_INTERRUPT
#        -> drivers/misc/renesas_ra_external_interrupt/Kconfig. "default y" once a
#           renesas,ra-external-interrupt node is enabled; the stock ek_ra8d1.dts
#           already enables &port_irq12 (P008/S2) and &port_irq13 (P009/S1), so
#           this is really redundant - set explicitly so the dependency is visible.
#           Without it the RA ioport driver returns -ENOTSUP for GPIO_INT_ENABLE
#           (gpio_renesas_ra_ioport.c:83).
#   CONFIG_LOG / CONFIG_LOG_DEFAULT_LEVEL -> subsys/logging/Kconfig
#
# The periodic timer (log_timer.c) uses the kernel k_timer API, which is always
# built in - no Kconfig needed. See log_timer.c for why k_timer over the on-chip
# AGT counter.

CONFIG_GPIO=y
CONFIG_RENESAS_RA_EXTERNAL_INTERRUPT=y

CONFIG_LOG=y
CONFIG_LOG_DEFAULT_LEVEL=3
```

## src/main.c
```c
/*
 * SPDX-License-Identifier: Apache-2.0
 *
 * Phase 2B demo entry point (build-only, no board).
 *
 * Compiles and links the two independent modules and shows how they connect:
 *   io_control  - S1/S2 buttons (edge IRQ) drive capture start/stop, LEDs show
 *                 state (green idle / red blinking while logging).
 *   log_timer   - "Timer" deliverable: a periodic tick that will timestamp CAN
 *                 frames and trigger batched flash flushes.
 *
 * The wiring here (start capture -> start the tick, stop -> stop the tick) is
 * done in main so the modules stay decoupled and each stays build-testable on
 * its own. Nothing runs without hardware; there is no flashing in this phase.
 */

#include <zephyr/kernel.h>
#include <zephyr/logging/log.h>

#include "io_control.h"
#include "log_timer.h"

LOG_MODULE_REGISTER(main, LOG_LEVEL_INF);

/* Periodic flush cadence - matches STATE.md's "batch writes, don't write one
 * flash page per CAN frame" decision. Tunable once real bus load is measured.
 */
#define FLUSH_PERIOD_MS 100U

/* Tick handler - ISR context (k_timer expiry). */
static void on_tick(uint32_t seq, uint64_t uptime_ticks, void *user_data)
{
	ARG_UNUSED(user_data);

	/* In the integrated system: swap buffers and submit a k_work item to
	 * write the filled batch to littlefs (Phase 2D). Here we just log.
	 */
	LOG_INF("flush tick #%u ts=%llu", seq, (unsigned long long)uptime_ticks);
}

/* Capture state-change handler - may be ISR context (button interrupt). */
static void on_capture_state(enum capture_state new_state, void *user_data)
{
	ARG_UNUSED(user_data);

	if (new_state == CAPTURE_LOGGING) {
		LOG_INF("capture START -> periodic flush timer on");
		(void)log_timer_start(FLUSH_PERIOD_MS, on_tick, NULL);
	} else {
		LOG_INF("capture STOP -> periodic flush timer off");
		log_timer_stop();
	}
}

int main(void)
{
	int ret;

	ret = io_control_init();
	if (ret != 0) {
		LOG_ERR("io_control_init failed: %d", ret);
		return 0;
	}

	io_control_set_callback(on_capture_state, NULL);

	/* Exercise the path without a physical button press so a build/run on
	 * future hardware shows the timer ticking even before anyone touches S1.
	 */
	io_control_request(CAPTURE_LOGGING);
	k_sleep(K_MSEC(500));
	io_control_request(CAPTURE_IDLE);

	LOG_INF("gpio_timer demo idle; press S1 to start, S2 to stop");
	return 0;
}
```

## include/io_control.h
```c
/*
 * SPDX-License-Identifier: Apache-2.0
 *
 * Phase 2B - button-driven capture control + LED status indication for the
 * EK-RA8D1. Self-contained: this module knows nothing about CAN, flash or the
 * log timer. main.c wires it to the rest for the build/demo only.
 *
 * Buttons (stock ek_ra8d1.dts "buttons" gpio-keys node):
 *   S1 = button0 = P009 (ioport0 pin 9)  -> external IRQ13 (NVIC vector 89)
 *   S2 = button1 = P008 (ioport0 pin 8)  -> external IRQ12 (NVIC vector 88)
 *   Both are wired GPIO_PULL_UP | GPIO_ACTIVE_LOW (pressed = logic low).
 *   S1 => start capture, S2 => stop capture. Edge-triggered interrupts,
 *   handled via gpio_add_callback() -> callback in ISR context. This is a
 *   second concrete "Interrupt + NVIC" data point for the university report
 *   (the CAN RX path in apps/can_logger is the primary one).
 *
 * LEDs (stock ek_ra8d1.dts "leds" gpio-leds node, all GPIO_ACTIVE_HIGH):
 *   led1 = P600 (ioport6.0), led2 = P40E (ioport4.14), led3 = P107 (ioport1.7)
 *   Colour<->designator mapping is per the EK-RA8D1 user manual silkscreen and
 *   is NOT verifiable from the Zephyr tree (anti-hallucination rule 2). Adjust
 *   the LED_* selectors in io_control.c if the board disagrees.
 *   Indication: IDLE => green steady, LOGGING => red blinking.
 */

#ifndef GPIO_TIMER_IO_CONTROL_H_
#define GPIO_TIMER_IO_CONTROL_H_

#include <stdint.h>

enum capture_state {
	CAPTURE_IDLE = 0,
	CAPTURE_LOGGING = 1,
};

/**
 * @brief Capture state-change notification.
 *
 * Invoked from a button GPIO interrupt callback (ISR context) or from
 * io_control_request(). Keep it short and non-blocking.
 */
typedef void (*io_capture_cb_t)(enum capture_state new_state, void *user_data);

/**
 * @brief Configure the two user buttons (edge interrupts) and three user LEDs,
 *        set the initial IDLE indication.
 *
 * @retval 0 on success
 * @retval -ENODEV  a gpio-keys / gpio-leds port is not ready
 * @retval <0       errno from gpio_pin_configure()/gpio_pin_interrupt_configure()
 */
int io_control_init(void);

/** Register the state-change callback. Pass NULL to detach. Returns 0. */
int io_control_set_callback(io_capture_cb_t cb, void *user_data);

/** Current capture state. */
enum capture_state io_control_get_state(void);

/**
 * @brief Programmatic equivalent of a button press (same path the ISR takes).
 *        Useful for the build/demo and for a future GUI "start/stop" command.
 */
void io_control_request(enum capture_state desired);

#endif /* GPIO_TIMER_IO_CONTROL_H_ */
```

## include/log_timer.h
```c
/*
 * SPDX-License-Identifier: Apache-2.0
 *
 * Phase 2B - periodic timer module. THIS IS THE "TIMER" DELIVERABLE for the
 * BITS Pilani WILP Embedded Systems Design report.
 *
 * Purpose in the wider system (not wired up until hardware integration):
 *   1. Provide a monotonic timestamp source for CAN frames captured by the
 *      Phase 2A module (apps/can_logger uses k_uptime_ticks() in its RX ISR;
 *      log_timer_timestamp() returns the same clock so the two agree).
 *   2. Fire a periodic "flush trigger" so the Phase 2D flash logger writes
 *      buffered frames in batches instead of one flash write per frame.
 *
 * Implementation: Zephyr kernel k_timer (see log_timer.c for why k_timer and
 * not the on-chip AGT counter). Self-contained: no dependency on io_control,
 * CAN or flash - main.c connects it to the rest for the build/demo only.
 */

#ifndef GPIO_TIMER_LOG_TIMER_H_
#define GPIO_TIMER_LOG_TIMER_H_

#include <stdint.h>

/**
 * @brief Periodic tick callback.
 *
 * @param seq           tick counter since log_timer_start() (starts at 1)
 * @param uptime_ticks  k_uptime_ticks() sampled at expiry
 * @param user_data     pointer passed to log_timer_start()
 *
 * Runs in the system timer / ISR context - keep it short and non-blocking
 * (submit a k_work item for anything heavy such as an actual flash flush).
 */
typedef void (*log_timer_tick_cb_t)(uint32_t seq, uint64_t uptime_ticks, void *user_data);

/**
 * @brief Start the periodic tick.
 *
 * @param period_ms  tick period in milliseconds (must be > 0)
 * @param cb         callback, or NULL for a bare timekeeping tick
 * @param user_data  opaque pointer handed back to @p cb
 * @retval 0        on success
 * @retval -EINVAL  period_ms == 0
 * @retval -EALREADY already running
 */
int log_timer_start(uint32_t period_ms, log_timer_tick_cb_t cb, void *user_data);

/** Stop the periodic tick. Safe to call when already stopped. */
void log_timer_stop(void);

/** @return number of ticks elapsed since log_timer_start(). */
uint32_t log_timer_seq(void);

/**
 * @brief Monotonic timestamp for tagging CAN frames.
 * @return k_uptime_ticks() - same clock the Phase 2A RX ISR samples.
 */
uint64_t log_timer_timestamp(void);

#endif /* GPIO_TIMER_LOG_TIMER_H_ */
```

## src/io_control.c
```c
/*
 * SPDX-License-Identifier: Apache-2.0
 *
 * Phase 2B - buttons + LEDs. Build-only; no board attached, nothing is flashed.
 */

#include <zephyr/kernel.h>
#include <zephyr/drivers/gpio.h>
#include <zephyr/logging/log.h>

#include "io_control.h"

LOG_MODULE_REGISTER(io_control, LOG_LEVEL_INF);

/* --- devicetree handles (stock ek_ra8d1.dts) --------------------------------
 * button0 = S1 = P009 (start), button1 = S2 = P008 (stop). Both children of
 * the "buttons" gpio-keys node and both on ioport0, so a single gpio_callback
 * registered on that port covers both edges.
 */
#define BTN_START_NODE  DT_NODELABEL(button0)
#define BTN_STOP_NODE   DT_NODELABEL(button1)

BUILD_ASSERT(DT_SAME_NODE(DT_GPIO_CTLR(BTN_START_NODE, gpios),
			  DT_GPIO_CTLR(BTN_STOP_NODE, gpios)),
	     "both user buttons are expected to share one ioport");

static const struct gpio_dt_spec btn_start = GPIO_DT_SPEC_GET(BTN_START_NODE, gpios);
static const struct gpio_dt_spec btn_stop  = GPIO_DT_SPEC_GET(BTN_STOP_NODE, gpios);

/* LED colour selectors - see io_control.h note on the mapping caveat. */
#define LED_GREEN_NODE  DT_NODELABEL(led2)   /* P40E */
#define LED_RED_NODE    DT_NODELABEL(led3)   /* P107 */
#define LED_AUX_NODE    DT_NODELABEL(led1)   /* P600 - unused for now */

static const struct gpio_dt_spec led_green = GPIO_DT_SPEC_GET(LED_GREEN_NODE, gpios);
static const struct gpio_dt_spec led_red   = GPIO_DT_SPEC_GET(LED_RED_NODE, gpios);

/* --- module state --------------------------------------------------------- */
static struct gpio_callback btn_cb_data;
static io_capture_cb_t user_cb;
static void *user_cb_data;
static enum capture_state state = CAPTURE_IDLE;

/* Software debounce: drop repeat edges on the same button inside this window.
 * The gpio-keys nodes have no debounce-interval-ms and this SoC's IRQ input
 * has only a digital noise filter, so bounce rejection is our job.
 */
#define DEBOUNCE_MS 40
static int64_t last_edge_ms;

/* LED blink while logging. This k_timer is a status-indicator detail only; the
 * report's "Timer" deliverable is the separate periodic tick in log_timer.c.
 */
static void blink_expiry(struct k_timer *t);
static K_TIMER_DEFINE(blink_timer, blink_expiry, NULL);

static void blink_expiry(struct k_timer *t)
{
	ARG_UNUSED(t);
	gpio_pin_toggle_dt(&led_red);
}

static void apply_indication(enum capture_state s)
{
	if (s == CAPTURE_LOGGING) {
		gpio_pin_set_dt(&led_green, 0);
		gpio_pin_set_dt(&led_red, 1);
		k_timer_start(&blink_timer, K_MSEC(250), K_MSEC(250));
	} else {
		k_timer_stop(&blink_timer);
		gpio_pin_set_dt(&led_red, 0);
		gpio_pin_set_dt(&led_green, 1);
	}
}

static void set_state(enum capture_state s)
{
	if (s == state) {
		return;
	}
	state = s;
	apply_indication(s);

	if (user_cb != NULL) {
		user_cb(s, user_cb_data);
	}
}

/*
 * Button GPIO interrupt callback - ISR context.
 *
 * "Interrupt + NVIC" (university report): P009/S1 is routed to RA external
 * interrupt IRQ13 (NVIC vector 89, priority 12) and P008/S2 to IRQ12 (vector
 * 88, priority 12); both port_irq nodes are enabled by boards/renesas/
 * ek_ra8d1/ek_ra8d1.dts. The Zephyr RA ioport driver
 * (drivers/gpio/gpio_renesas_ra_ioport.c) owns the ISR and fans out here via
 * gpio_fire_callbacks(). Keep this handler short and non-blocking.
 */
static void button_isr(const struct device *port, struct gpio_callback *cb, uint32_t pins)
{
	ARG_UNUSED(port);
	ARG_UNUSED(cb);

	int64_t now = k_uptime_get();

	if ((now - last_edge_ms) < DEBOUNCE_MS) {
		return;
	}
	last_edge_ms = now;

	if (pins & BIT(btn_start.pin)) {
		set_state(CAPTURE_LOGGING);
	} else if (pins & BIT(btn_stop.pin)) {
		set_state(CAPTURE_IDLE);
	}
}

int io_control_init(void)
{
	int ret;

	if (!gpio_is_ready_dt(&led_green) || !gpio_is_ready_dt(&led_red)) {
		return -ENODEV;
	}
	if (!gpio_is_ready_dt(&btn_start) || !gpio_is_ready_dt(&btn_stop)) {
		return -ENODEV;
	}

	ret = gpio_pin_configure_dt(&led_green, GPIO_OUTPUT_INACTIVE);
	if (ret == 0) {
		ret = gpio_pin_configure_dt(&led_red, GPIO_OUTPUT_INACTIVE);
	}
	if (ret != 0) {
		LOG_ERR("LED configure failed: %d", ret);
		return ret;
	}

	ret = gpio_pin_configure_dt(&btn_start, GPIO_INPUT);
	if (ret == 0) {
		ret = gpio_pin_configure_dt(&btn_stop, GPIO_INPUT);
	}
	if (ret != 0) {
		LOG_ERR("button configure failed: %d", ret);
		return ret;
	}

	/* GPIO_INT_EDGE_TO_ACTIVE = falling edge, since the buttons are
	 * GPIO_ACTIVE_LOW - i.e. fire on press, not release.
	 */
	ret = gpio_pin_interrupt_configure_dt(&btn_start, GPIO_INT_EDGE_TO_ACTIVE);
	if (ret == 0) {
		ret = gpio_pin_interrupt_configure_dt(&btn_stop, GPIO_INT_EDGE_TO_ACTIVE);
	}
	if (ret != 0) {
		LOG_ERR("button IRQ configure failed: %d "
			"(is CONFIG_RENESAS_RA_EXTERNAL_INTERRUPT set?)", ret);
		return ret;
	}

	gpio_init_callback(&btn_cb_data, button_isr,
			   BIT(btn_start.pin) | BIT(btn_stop.pin));
	ret = gpio_add_callback_dt(&btn_start, &btn_cb_data);
	if (ret != 0) {
		LOG_ERR("gpio_add_callback failed: %d", ret);
		return ret;
	}

	state = CAPTURE_IDLE;
	apply_indication(state);
	LOG_INF("io_control ready: S1(P009)=start S2(P008)=stop, green=idle");
	return 0;
}

int io_control_set_callback(io_capture_cb_t cb, void *user_data)
{
	user_cb = cb;
	user_cb_data = user_data;
	return 0;
}

enum capture_state io_control_get_state(void)
{
	return state;
}

void io_control_request(enum capture_state desired)
{
	set_state(desired);
}
```

## src/log_timer.c
```c
/*
 * SPDX-License-Identifier: Apache-2.0
 *
 * Phase 2B - "Timer" deliverable. Build-only; nothing is flashed.
 *
 * WHY k_timer AND NOT THE ON-CHIP AGT:
 *   PROMPTS.md Phase 2B says "k_timer or the on-chip AGT counter - check which
 *   is simpler in this Zephyr version". k_timer wins here:
 *     - No devicetree overlay. agt0/agt1 (renesas,ra-agt @0x40221000/0x40221100,
 *       NVIC IRQ 83 "agti") are status=disabled in
 *       dts/arm/renesas/ra/ra8/ra8x1.dtsi and the ek_ra8d1 board never enables
 *       them, so AGT would need an overlay turning on &agt0 *and* its child
 *       counter node.
 *     - No extra Kconfig. AGT would need CONFIG_COUNTER + CONFIG_COUNTER_RA_AGT
 *       (drivers/counter/counter_renesas_ra_agt.c) and the counter-alarm API.
 *     - k_timer is always built into the kernel and its period/callback model
 *       is exactly what a "timestamp + periodic flush" tick needs.
 *   The AGT path stays documented above as the hardware-timer alternative if a
 *   later phase needs a timer that keeps running through deep sleep or needs
 *   sub-tick resolution independent of CONFIG_SYS_CLOCK_TICKS_PER_SEC.
 *
 * The k_timer expiry function runs in the system clock announce context
 * (ISR context on this SoC) - see the Zephyr k_timer docs. Treat it like an
 * ISR: short, non-blocking.
 */

#include <zephyr/kernel.h>
#include <zephyr/logging/log.h>

#include "log_timer.h"

LOG_MODULE_REGISTER(log_timer, LOG_LEVEL_INF);

static void tick_expiry(struct k_timer *t);
static K_TIMER_DEFINE(periodic, tick_expiry, NULL);

static log_timer_tick_cb_t tick_cb;
static void *tick_cb_data;
static uint32_t tick_seq;
static bool running;

static void tick_expiry(struct k_timer *t)
{
	ARG_UNUSED(t);

	uint32_t seq = ++tick_seq;
	uint64_t ts = k_uptime_ticks();

	if (tick_cb != NULL) {
		tick_cb(seq, ts, tick_cb_data);
	}
}

int log_timer_start(uint32_t period_ms, log_timer_tick_cb_t cb, void *user_data)
{
	if (period_ms == 0U) {
		return -EINVAL;
	}
	if (running) {
		return -EALREADY;
	}

	tick_cb = cb;
	tick_cb_data = user_data;
	tick_seq = 0U;
	running = true;

	/* First expiry one period out, then repeat every period. */
	k_timer_start(&periodic, K_MSEC(period_ms), K_MSEC(period_ms));
	LOG_INF("periodic tick started: %u ms", period_ms);
	return 0;
}

void log_timer_stop(void)
{
	if (!running) {
		return;
	}
	k_timer_stop(&periodic);
	running = false;
	tick_cb = NULL;
	tick_cb_data = NULL;
	LOG_INF("periodic tick stopped after %u ticks", tick_seq);
}

uint32_t log_timer_seq(void)
{
	return tick_seq;
}

uint64_t log_timer_timestamp(void)
{
	return k_uptime_ticks();
}
```
