## CMakeLists.txt
```
# SPDX-License-Identifier: Apache-2.0
#
# Phase 2C: USB CDC-ACM device + CLP framing protocol (build-only, no board).
# Board target: ek_ra8d1. The CDC-ACM DT node is added by
# boards/ek_ra8d1.overlay (auto-applied by filename).

cmake_minimum_required(VERSION 3.28.0)

find_package(Zephyr REQUIRED HINTS $ENV{ZEPHYR_BASE})
project(usb_cdc)

target_include_directories(app PRIVATE include)
target_sources(app PRIVATE
  src/main.c
  src/clp_proto.c
  src/usb_link.c
  src/usbd_ctx.c
)
```

## prj.conf
```kconfig
# Phase 2C - USB CDC-ACM + CLP framing. Every symbol checked against the
# workspace before being added.
#
#   CONFIG_USB_DEVICE_STACK_NEXT -> subsys/usb/device_next/Kconfig:5. The new
#        ("next") USB device stack - what zephyr/samples/subsys/usb/cdc_acm
#        uses. Pulls UDC_DRIVER; on this board UDC_RENESAS_RA
#        (drivers/usb/udc/Kconfig.renesas_ra) is "default y" because
#        &usbhs/zephyr_udc0 (compatible "renesas,ra-udc") is enabled by
#        boards/renesas/ek_ra8d1/ek_ra8d1.dts. High-Speed capable, so
#        USBD_MAX_SPEED defaults to High.
#   CONFIG_USBD_CDC_ACM_CLASS   -> subsys/usb/device_next/class/Kconfig.cdc_acm.
#        "default y" once a zephyr,cdc-acm-uart node exists (added in
#        boards/ek_ra8d1.overlay). Selects RING_BUFFER + UART_INTERRUPT_DRIVEN.
#        Set explicitly so the dependency is visible.
#   CONFIG_UART_LINE_CTRL       -> drivers/serial/Kconfig. Needed for the DTR
#        (host-opened-port) query in usb_link.c.
#   CONFIG_COBS                 -> lib/utils/Kconfig:94. COBS framing used by
#        clp_proto.c (<zephyr/data/cobs.h> streaming encoder/decoder).
#   CONFIG_CRC                  -> subsys/crc/Kconfig:7. Provides crc16_ccitt()
#        used for the CLP CRC-16/X-25. CONFIG_CRC_HW_HANDLER is forced off: the
#        board's on-chip CRC peripheral (chosen zephyr,crc = &crc) would pull
#        an extra driver we don't use - clp_proto.c calls the SW crc16_ccitt().
#   CONFIG_RING_BUFFER         -> lib/os/Kconfig. tx_rb in usb_link.c.
#   CONFIG_LOG                 -> subsys/logging/Kconfig.

CONFIG_USB_DEVICE_STACK_NEXT=y
CONFIG_USBD_CDC_ACM_CLASS=y

CONFIG_SERIAL=y
CONFIG_UART_INTERRUPT_DRIVEN=y
CONFIG_UART_LINE_CTRL=y
CONFIG_RING_BUFFER=y

CONFIG_COBS=y
CONFIG_CRC=y
CONFIG_CRC_HW_HANDLER=n

CONFIG_LOG=y
CONFIG_LOG_DEFAULT_LEVEL=3

# Quieten the USB stack's own logging (matches the cdc_acm sample).
CONFIG_USBD_LOG_LEVEL_ERR=y
CONFIG_UDC_DRIVER_LOG_LEVEL_ERR=y
CONFIG_USBD_CDC_ACM_LOG_LEVEL_OFF=y

# Main-thread stack. The Zephyr default (1024) OVERFLOWS here: clp_selftest()
# holds a struct clp_parser (87-byte frame buf + cobs_decoder), a
# struct clp_can_frame (64 data bytes) and uint8_t wire[CLP_MAX_WIRE] on the
# stack, then calls clp_encode_raw(), which nests another 87-byte logical[]
# plus a cobs_encoder. On hardware (2026-08-31) that corrupted the return
# address and faulted on main()'s return: "USAGE FAULT / Illegal load of
# EXC_RETURN into PC", PC in unmapped SRAM, with the self-test's own CAN
# payload visible in the dumped FP registers. Phase 2D's flash_log sets this
# explicitly for the same reason.
CONFIG_MAIN_STACK_SIZE=4096
```

## boards/ek_ra8d1.overlay
```dts
/*
 * App-local devicetree overlay for apps/usb_cdc on the EK-RA8D1.
 * Zephyr auto-applies <app>/boards/<board>.overlay by filename.
 *
 * Adds a CDC-ACM function to the USB device controller. zephyr_udc0 is the
 * `udc` child of &usbhs (compatible "renesas,ra-udc"), already set
 * status = "okay" by boards/renesas/ek_ra8d1/ek_ra8d1.dts - usbhs is the
 * High-Speed USB *device* port and is the one enabled by the stock board
 * (usbfs is only pinctrl'd, not enabled). Same node shape as
 * zephyr/samples/subsys/usb/cdc_acm/app.overlay.
 */

&zephyr_udc0 {
	cdc_acm_uart0: cdc_acm_uart0 {
		compatible = "zephyr,cdc-acm-uart";
		label = "CLP CDC-ACM";
	};
};
```

## src/main.c
```c
/*
 * SPDX-License-Identifier: Apache-2.0
 *
 * Phase 2C demo entry point (build-only, no board).
 *
 * 1. Runs a pure CLP encode -> parse round-trip self-test that needs no USB
 *    and no CAN hardware, exercising clp_proto.c end to end (framing, CRC,
 *    COBS, resync after a corrupted byte).
 * 2. Brings up the USB CDC-ACM link and shows the wiring points: a
 *    CLP_MSG_CAN_TX handler (host -> device) and a CLP_MSG_CAN_RX send
 *    (device -> host). Nothing enumerates without a host; there is no
 *    flashing in this phase.
 */

#include <errno.h>
#include <string.h>

#include <zephyr/kernel.h>
#include <zephyr/logging/log.h>

#include "clp_proto.h"
#include "usb_link.h"

LOG_MODULE_REGISTER(main, LOG_LEVEL_INF);

/* ---- self-test scaffolding ---------------------------------------------- */

static struct clp_can_frame st_last;
static uint8_t st_last_type;
static int st_count;

static void st_frame_cb(uint8_t type, uint8_t seq, const uint8_t *payload,
			uint16_t len, void *user_data)
{
	ARG_UNUSED(seq);
	ARG_UNUSED(user_data);

	st_last_type = type;
	st_count++;
	if (type == CLP_MSG_CAN_RX || type == CLP_MSG_CAN_TX) {
		(void)clp_decode_can_frame(payload, len, &st_last);
	}
}

static bool clp_selftest(void)
{
	struct clp_parser p;
	struct clp_can_frame in = {
		.can_id = 0x1ABCDEF0,
		.flags = CLP_CANF_FDF | CLP_CANF_BRS | CLP_CANF_IDE,
		.dlc = 15,            /* 64 data bytes */
		.tag = 0,
		.timestamp = 0x0011223344556677ULL,
	};
	uint8_t wire[CLP_MAX_WIRE];
	int n;

	for (int i = 0; i < 64; i++) {
		in.data[i] = (uint8_t)(i ^ 0xA5); /* deliberately include 0xA5 */
	}

	clp_parser_init(&p, st_frame_cb, NULL);

	/* Happy path. */
	n = clp_encode_can_frame(CLP_MSG_CAN_RX, 7, &in, wire, sizeof(wire));
	if (n <= 0) {
		LOG_ERR("selftest: encode failed %d", n);
		return false;
	}
	LOG_INF("selftest: FD-64 frame -> %d wire bytes (fixed struct would be 80)", n);

	st_count = 0;
	clp_parser_feed(&p, wire, (size_t)n);
	if (st_count != 1 || st_last_type != CLP_MSG_CAN_RX ||
	    st_last.can_id != in.can_id || st_last.dlc != in.dlc ||
	    st_last.timestamp != in.timestamp ||
	    memcmp(st_last.data, in.data, 64) != 0) {
		LOG_ERR("selftest: round-trip mismatch (count %d)", st_count);
		return false;
	}

	/* Corruption + resync: flip a byte mid-frame, then send a good frame. */
	uint8_t bad[CLP_MAX_WIRE];

	memcpy(bad, wire, (size_t)n);
	bad[10] ^= 0xFF;

	st_count = 0;
	clp_parser_feed(&p, bad, (size_t)n);          /* should be rejected */
	n = clp_encode_can_frame(CLP_MSG_CAN_RX, 8, &in, wire, sizeof(wire));
	clp_parser_feed(&p, wire, (size_t)n);         /* must still parse   */

	if (st_count != 1) {
		LOG_ERR("selftest: resync failed (delivered %d)", st_count);
		return false;
	}
	if (p.crc_errors + p.framing_errors == 0) {
		LOG_ERR("selftest: corrupted frame was not counted");
		return false;
	}

	LOG_INF("selftest PASS (crc_err=%u framing_err=%u frames_ok=%u)",
		p.crc_errors, p.framing_errors, p.frames_ok);
	return true;
}

/* ---- USB link demo ----------------------------------------------------- */

static void on_tx_request(const struct clp_can_frame *req, void *user_data)
{
	ARG_UNUSED(user_data);

	LOG_INF("host asked to TX: id=0x%08x dlc=%u flags=0x%02x tag=%u",
		req->can_id, req->dlc, req->flags, req->tag);

	/* When wired to Phase 2A: can_iface_send(req) then usb_link_send_tx_ack(). */
}

int main(void)
{
	uint32_t txf, drops, crce, frme;
	int ret;

	if (!clp_selftest()) {
		LOG_ERR("CLP self-test FAILED");
		return 0;
	}

	ret = usb_link_init();
	if (ret != 0) {
		LOG_ERR("usb_link_init failed: %d", ret);
		return 0;
	}

	usb_link_set_tx_handler(on_tx_request, NULL);

	/* Try one live-frame send. Off-bench this returns -ENOTCONN (no host). */
	struct clp_can_frame live = {
		.can_id = 0x123,
		.flags = CLP_CANF_FDF | CLP_CANF_BRS,
		.dlc = 8,
		.timestamp = k_uptime_ticks(),
	};

	for (int i = 0; i < 8; i++) {
		live.data[i] = (uint8_t)i;
	}

	ret = usb_link_send_can_rx(&live);
	LOG_INF("usb_link_send_can_rx -> %d (%s)", ret,
		ret == -ENOTCONN ? "no host, expected off-bench" : "queued");

	usb_link_get_counters(&txf, &drops, &crce, &frme);
	LOG_INF("counters: tx_frames=%u rx_drops=%u crc_err=%u framing_err=%u",
		txf, drops, crce, frme);

	return 0;
}
```

## include/clp_proto.h
```c
/*
 * SPDX-License-Identifier: Apache-2.0
 *
 * Phase 2C - CLP: "CAN Log Protocol" v1.
 *
 * A small binary framing protocol for the USB CDC-ACM link between the board
 * and the host GUI. Design follows common industrial serial-link practice
 * (SLCAN / Vector BLF / MAVLink-style telemetry / nanopb+COBS links):
 *
 *   - Self-synchronising framing: each logical frame is COBS-encoded
 *     (Consistent Overhead Byte Stuffing, RFC-less but ubiquitous) and
 *     terminated by a single 0x00 byte. COBS guarantees the encoded frame
 *     contains no 0x00, so 0x00 is an unambiguous, instant resync point after
 *     any corruption. A bare magic byte cannot do this (0xA5 occurs naturally
 *     in CAN id/data/timestamp bytes). Zephyr ships COBS: CONFIG_COBS,
 *     <zephyr/data/cobs.h> streaming API.
 *   - Strong integrity: CRC-16/X-25 (poly 0x1021, seed 0xFFFF, reflected,
 *     xorout 0xFFFF) over the logical frame - same family as MAVLink / HDLC.
 *     A sum/XOR checksum misses most multi-bit and transposition errors.
 *     Zephyr: crc16_ccitt() in <zephyr/sys/crc.h>.
 *   - Versioned, typed header so the bidirectional link can carry live frames,
 *     TX commands, status and a connect handshake, and evolve later.
 *   - Explicit length + variable payload: only can_dlc_to_bytes(dlc) data
 *     bytes are put on the wire, not a fixed 64-byte array.
 *   - Per-direction rolling seq so the GUI can detect and count lost frames.
 *
 * Logical frame (little-endian), BEFORE COBS:
 *
 *   +------+------+------+---------+-----------------+-------------+
 *   | ver  | type | seq  |  len    |  payload[len]   |  crc16      |
 *   | u8=1 | u8   | u8   | u16 LE  |                 |  u16 LE     |
 *   +------+------+------+---------+-----------------+-------------+
 *   \_______________ crc covers these ______________/
 *
 * On the wire: COBS(logical frame) followed by one 0x00 delimiter.
 *
 * This header/module is deliberately independent of the USB stack and of the
 * Phase 2A CAN module - it only deals in bytes and plain structs, so it is
 * unit-testable on its own (see main.c's round-trip self-test).
 */

#ifndef USB_CDC_CLP_PROTO_H_
#define USB_CDC_CLP_PROTO_H_

#include <stdbool.h>
#include <stddef.h>
#include <stdint.h>

#include <zephyr/data/cobs.h>
#include <zephyr/sys/util.h>

#ifdef __cplusplus
extern "C" {
#endif

#define CLP_VERSION        0x01U

/* Header: ver(1) type(1) seq(1) len(2). Trailer: crc16(2). */
#define CLP_HEADER_SIZE    5U
#define CLP_CRC_SIZE       2U

/*
 * Largest payload we define is a CAN-FD frame message: 16 fixed bytes +
 * up to 64 data bytes (see struct layout in clp_encode_can_frame()).
 */
#define CLP_MAX_PAYLOAD    80U
#define CLP_MAX_FRAME      (CLP_HEADER_SIZE + CLP_MAX_PAYLOAD + CLP_CRC_SIZE)

/* Worst-case COBS expansion (+1 per 254 bytes, +1 code, +1 delimiter). */
#define CLP_MAX_WIRE       (CLP_MAX_FRAME + (CLP_MAX_FRAME / 254U) + 2U)

/** Message types. */
enum clp_msg_type {
	CLP_MSG_CAN_RX     = 0x01, /* device -> host: a received CAN(-FD) frame   */
	CLP_MSG_CAN_TX     = 0x02, /* host -> device: request to transmit a frame */
	CLP_MSG_CAN_TX_ACK = 0x03, /* device -> host: completion for a CAN_TX     */
	CLP_MSG_STATUS     = 0x04, /* device -> host: bus state + counters        */
	CLP_MSG_HELLO      = 0x05, /* device -> host: sent on connect (DTR)       */
};

/*
 * CAN-frame flags. These are CLP wire bits and are NOT numerically the same as
 * Zephyr's CAN_FRAME_* (e.g. CAN_FRAME_IDE is BIT(0), CLP_CANF_IDE is BIT(3)).
 * Code bridging the CLP layer to the Zephyr CAN API must translate explicitly —
 * see clp_flags_from_can() / can_flags_from_clp() in apps/can_logger/src/main.c.
 */
#define CLP_CANF_FDF  BIT(0) /* CAN-FD format frame          */
#define CLP_CANF_BRS  BIT(1) /* bit-rate switch (FD)         */
#define CLP_CANF_ESI  BIT(2) /* error state indicator (FD)   */
#define CLP_CANF_IDE  BIT(3) /* extended 29-bit identifier   */
#define CLP_CANF_RTR  BIT(4) /* remote transmission request  */

/**
 * @brief Decoded CAN frame carried by CLP_MSG_CAN_RX and CLP_MSG_CAN_TX.
 *
 * Field semantics mirror the Phase 2A struct canlog_frame, but @p flags uses
 * the CLP_CANF_* bit layout, not Zephyr's CAN_FRAME_* — translate at the edge.
 */
struct clp_can_frame {
	uint32_t can_id;      /* 11- or 29-bit id (no flag bits packed in)      */
	uint8_t  flags;       /* CLP_CANF_*                                     */
	uint8_t  dlc;         /* raw DLC; byte count = can_dlc_to_bytes(dlc)    */
	uint16_t tag;         /* CAN_TX: host correlation id echoed in the ACK; */
			      /* CAN_RX: 0                                      */
	uint64_t timestamp;   /* CAN_RX: k_uptime_ticks() at RX; CAN_TX: 0      */
	uint8_t  data[64];    /* first can_dlc_to_bytes(dlc) bytes are valid    */
};

/** CLP_MSG_CAN_TX_ACK payload (decoded). */
struct clp_tx_ack {
	uint16_t tag;         /* echoes the CAN_TX tag           */
	int16_t  status;      /* 0 = queued/sent OK, else -errno */
	uint64_t timestamp;   /* k_uptime_ticks() at TX callback */
};

/** CLP_MSG_STATUS payload (decoded). */
struct clp_status {
	uint8_t  bus_state;   /* enum can_state value                  */
	uint32_t rx_frames;   /* CAN frames handed to the link         */
	uint32_t tx_frames;   /* CAN_TX requests accepted              */
	uint32_t rx_drops;    /* frames dropped: host not draining USB */
	uint8_t  tx_err_cnt;  /* controller TX error counter           */
	uint8_t  rx_err_cnt;  /* controller RX error counter           */
};

/* -------------------------------------------------------------------------- */
/* Encoding - build a COBS-framed wire buffer (incl. trailing 0x00).          */
/* Each returns the wire length written to @p out, or negative errno.         */
/* -------------------------------------------------------------------------- */

int clp_encode_can_frame(enum clp_msg_type type, uint8_t seq,
			 const struct clp_can_frame *f,
			 uint8_t *out, size_t out_size);

int clp_encode_tx_ack(uint8_t seq, const struct clp_tx_ack *ack,
		      uint8_t *out, size_t out_size);

int clp_encode_status(uint8_t seq, const struct clp_status *st,
		      uint8_t *out, size_t out_size);

int clp_encode_hello(uint8_t seq, const char *fw_version,
		     uint8_t *out, size_t out_size);

/* -------------------------------------------------------------------------- */
/* Decoding helpers - turn a validated payload into a typed struct.           */
/* -------------------------------------------------------------------------- */

int clp_decode_can_frame(const uint8_t *payload, uint16_t len,
			 struct clp_can_frame *out);
int clp_decode_tx_ack(const uint8_t *payload, uint16_t len,
		      struct clp_tx_ack *out);
int clp_decode_status(const uint8_t *payload, uint16_t len,
		      struct clp_status *out);

/* -------------------------------------------------------------------------- */
/* Streaming parser - feed received bytes, get whole CRC-checked frames.      */
/* -------------------------------------------------------------------------- */

/**
 * @brief Called for every complete, length- and CRC-valid CLP frame.
 *
 * @param type     message type (enum clp_msg_type)
 * @param seq      sender's rolling sequence number
 * @param payload  pointer into the parser's frame buffer (valid for the call)
 * @param len      payload length
 * @param user_data pointer given to clp_parser_init()
 */
typedef void (*clp_frame_cb_t)(uint8_t type, uint8_t seq,
			       const uint8_t *payload, uint16_t len,
			       void *user_data);

struct clp_parser {
	struct cobs_decoder dec;
	clp_frame_cb_t cb;
	void *user_data;
	uint8_t frame[CLP_MAX_FRAME];
	size_t frame_len;
	bool overflow;         /* current frame exceeded CLP_MAX_FRAME */
	uint32_t crc_errors;   /* frames dropped: bad CRC              */
	uint32_t framing_errors; /* frames dropped: bad COBS/len       */
	uint32_t frames_ok;
};

void clp_parser_init(struct clp_parser *p, clp_frame_cb_t cb, void *user_data);

/**
 * @brief Feed received bytes into the parser.
 *
 * Complete frames are delivered via the callback registered at init.
 * @return 0 on success, negative errno on an unexpected internal error.
 */
int clp_parser_feed(struct clp_parser *p, const uint8_t *buf, size_t len);

/** CRC-16/X-25 over @p buf (poly 0x1021, seed 0xFFFF, reflected, xorout 0xFFFF). */
uint16_t clp_crc16(const uint8_t *buf, size_t len);

#ifdef __cplusplus
}
#endif

#endif /* USB_CDC_CLP_PROTO_H_ */
```

## include/usb_link.h
```c
/*
 * SPDX-License-Identifier: Apache-2.0
 *
 * Phase 2C - CDC-ACM transport glue for the CLP protocol.
 *
 * Owns the USB CDC-ACM UART: interrupt-driven byte I/O, an outbound byte ring
 * buffer, and a CLP streaming parser on the inbound side. Encodes outgoing
 * messages with clp_proto and hands decoded CLP_MSG_CAN_TX requests to a
 * registered handler.
 *
 * Independent of the Phase 2A CAN driver and the Phase 2B GPIO/timer module:
 * it deals only in struct clp_can_frame and friends. Wiring it to a real CAN
 * controller is an integration step for when hardware is available.
 */

#ifndef USB_CDC_USB_LINK_H_
#define USB_CDC_USB_LINK_H_

#include <stdbool.h>
#include <stdint.h>

#include "clp_proto.h"

#ifdef __cplusplus
extern "C" {
#endif

/** Invoked (in a thread context, not ISR) for each CLP_MSG_CAN_TX from the host. */
typedef void (*usb_link_tx_request_cb_t)(const struct clp_can_frame *req,
					 void *user_data);

/**
 * @brief Bring up the USB device and the CDC-ACM endpoint.
 *
 * Does not block waiting for the host. A HELLO frame is queued automatically
 * when the host asserts DTR.
 *
 * @retval 0        success
 * @retval -ENODEV  CDC-ACM UART or USB device not ready
 * @retval <0       errno from the USB stack
 */
int usb_link_init(void);

/** @return true once the host has opened the port (DTR asserted). */
bool usb_link_connected(void);

/** Register the CLP_MSG_CAN_TX handler. Pass NULL to detach. */
void usb_link_set_tx_handler(usb_link_tx_request_cb_t cb, void *user_data);

/**
 * @brief Queue a received CAN frame for the host as a CLP_MSG_CAN_RX.
 *
 * Non-blocking. If the outbound buffer is full (host not draining USB) the
 * frame is dropped and the rx-drop counter is incremented - CAN RX must never
 * stall on USB back-pressure.
 *
 * @retval 0        queued
 * @retval -ENOSPC  dropped, buffer full
 * @retval -ENOTCONN host not connected
 * @retval <0       encode error
 */
int usb_link_send_can_rx(const struct clp_can_frame *f);

/** Queue a CLP_MSG_CAN_TX_ACK for the host. Same semantics as above. */
int usb_link_send_tx_ack(const struct clp_tx_ack *ack);

/** Queue a CLP_MSG_STATUS for the host. Same semantics as above. */
int usb_link_send_status(const struct clp_status *st);

/** Snapshot of link counters (any pointer may be NULL). */
void usb_link_get_counters(uint32_t *tx_frames, uint32_t *rx_drops,
			   uint32_t *crc_errors, uint32_t *framing_errors);

#ifdef __cplusplus
}
#endif

#endif /* USB_CDC_USB_LINK_H_ */
```

## include/usbd_ctx.h
```c
/*
 * SPDX-License-Identifier: Apache-2.0
 *
 * Phase 2C - minimal USB device (stack "next") context for apps/usb_cdc.
 *
 * Templated from zephyr/samples/subsys/usb/common/sample_usbd_init.c, whose
 * header says to copy it into the application rather than depend on it.
 */

#ifndef USB_CDC_USBD_CTX_H_
#define USB_CDC_USBD_CTX_H_

#include <zephyr/usb/usbd.h>

/**
 * @brief Build and initialise the USB device context (one FS + one HS config,
 *        all compiled-in classes registered, message callback attached).
 *
 * Does NOT call usbd_enable() - the caller decides when, based on VBUS.
 *
 * @return the initialised context, or NULL on failure.
 */
struct usbd_context *usb_cdc_init_usbd(usbd_msg_cb_t msg_cb);

#endif /* USB_CDC_USBD_CTX_H_ */
```

## src/clp_proto.c
```c
/*
 * SPDX-License-Identifier: Apache-2.0
 *
 * Phase 2C - CLP v1 encode / decode / streaming parser. Build-only.
 *
 * No dependency on the USB stack or the Phase 2A CAN driver: this file only
 * manipulates byte buffers and plain structs, so main.c can exercise it with a
 * pure encode -> parse round trip that needs no hardware.
 */

#include <errno.h>
#include <string.h>

#include <zephyr/sys/byteorder.h>
#include <zephyr/sys/crc.h>

#include "clp_proto.h"

/* Payload sizes (fixed part). */
#define CLP_CANF_FIXED   16U  /* can_id(4) flags(1) dlc(1) tag(2) timestamp(8) */
#define CLP_TX_ACK_SIZE  12U  /* tag(2) status(2) timestamp(8)                 */
#define CLP_STATUS_SIZE  15U  /* state(1) rx(4) tx(4) drops(4) txerr(1) rxerr(1) */
#define CLP_HELLO_FIXED   3U  /* proto_ver(1) max_payload(2) + fw string        */

uint16_t clp_crc16(const uint8_t *buf, size_t len)
{
	/* CRC-16/X-25: poly 0x1021, seed 0xFFFF, reflect in/out, xorout 0xFFFF. */
	return crc16_ccitt(0xFFFFU, buf, len) ^ 0xFFFFU;
}

/*
 * CAN-FD Data Length Code -> payload byte count. Local copy of the standard
 * table so this module needs no <zephyr/drivers/can.h> / CONFIG_CAN.
 */
static uint8_t clp_dlc_to_bytes(uint8_t dlc)
{
	static const uint8_t tbl[16] = {
		0, 1, 2, 3, 4, 5, 6, 7, 8, 12, 16, 20, 24, 32, 48, 64,
	};

	return tbl[dlc & 0x0FU];
}

/* -------------------------------------------------------------------------- */
/* COBS output sink: append encoded bytes into a fixed caller buffer.         */
/* -------------------------------------------------------------------------- */
struct cobs_sink {
	uint8_t *out;
	size_t size;
	size_t pos;
};

static int cobs_sink_cb(const uint8_t *buf, size_t len, void *user_data)
{
	struct cobs_sink *s = user_data;

	if (s->pos + len > s->size) {
		return -ENOMEM;
	}
	memcpy(&s->out[s->pos], buf, len);
	s->pos += len;
	return 0;
}

/*
 * Build header + payload + CRC, then COBS-frame it (with trailing 0x00) into
 * @p out. Returns wire length or negative errno.
 */
static int clp_encode_raw(enum clp_msg_type type, uint8_t seq,
			  const uint8_t *payload, uint16_t plen,
			  uint8_t *out, size_t out_size)
{
	uint8_t logical[CLP_MAX_FRAME];
	struct cobs_sink sink = { .out = out, .size = out_size, .pos = 0 };
	struct cobs_encoder enc;
	uint16_t crc;
	size_t total;
	int ret;

	if (plen > CLP_MAX_PAYLOAD) {
		return -EINVAL;
	}

	logical[0] = CLP_VERSION;
	logical[1] = (uint8_t)type;
	logical[2] = seq;
	sys_put_le16(plen, &logical[3]);
	if (plen > 0U) {
		memcpy(&logical[CLP_HEADER_SIZE], payload, plen);
	}
	crc = clp_crc16(logical, CLP_HEADER_SIZE + plen);
	sys_put_le16(crc, &logical[CLP_HEADER_SIZE + plen]);
	total = CLP_HEADER_SIZE + plen + CLP_CRC_SIZE;

	ret = cobs_encoder_init(&enc, cobs_sink_cb, &sink,
				COBS_FLAG_TRAILING_DELIMITER);
	if (ret < 0) {
		return ret;
	}
	ret = cobs_encoder_write(&enc, logical, total);
	if (ret < 0) {
		return ret;
	}
	ret = cobs_encoder_close(&enc);
	if (ret < 0) {
		return ret;
	}

	return (int)sink.pos;
}

int clp_encode_can_frame(enum clp_msg_type type, uint8_t seq,
			 const struct clp_can_frame *f,
			 uint8_t *out, size_t out_size)
{
	uint8_t payload[CLP_MAX_PAYLOAD];
	uint8_t n;

	if (type != CLP_MSG_CAN_RX && type != CLP_MSG_CAN_TX) {
		return -EINVAL;
	}

	n = clp_dlc_to_bytes(f->dlc);
	if ((f->flags & CLP_CANF_RTR) != 0U) {
		n = 0U; /* remote frame carries no data */
	}

	sys_put_le32(f->can_id, &payload[0]);
	payload[4] = f->flags;
	payload[5] = f->dlc;
	sys_put_le16(f->tag, &payload[6]);
	sys_put_le64(f->timestamp, &payload[8]);
	memcpy(&payload[CLP_CANF_FIXED], f->data, n);

	return clp_encode_raw(type, seq, payload, CLP_CANF_FIXED + n,
			      out, out_size);
}

int clp_encode_tx_ack(uint8_t seq, const struct clp_tx_ack *ack,
		      uint8_t *out, size_t out_size)
{
	uint8_t payload[CLP_TX_ACK_SIZE];

	sys_put_le16(ack->tag, &payload[0]);
	sys_put_le16((uint16_t)ack->status, &payload[2]);
	sys_put_le64(ack->timestamp, &payload[4]);

	return clp_encode_raw(CLP_MSG_CAN_TX_ACK, seq, payload, sizeof(payload),
			      out, out_size);
}

int clp_encode_status(uint8_t seq, const struct clp_status *st,
		      uint8_t *out, size_t out_size)
{
	uint8_t payload[CLP_STATUS_SIZE];

	payload[0] = st->bus_state;
	sys_put_le32(st->rx_frames, &payload[1]);
	sys_put_le32(st->tx_frames, &payload[5]);
	sys_put_le32(st->rx_drops, &payload[9]);
	payload[13] = st->tx_err_cnt;
	payload[14] = st->rx_err_cnt;

	return clp_encode_raw(CLP_MSG_STATUS, seq, payload, sizeof(payload),
			      out, out_size);
}

int clp_encode_hello(uint8_t seq, const char *fw_version,
		     uint8_t *out, size_t out_size)
{
	uint8_t payload[CLP_MAX_PAYLOAD];
	size_t fw_len = (fw_version != NULL) ? strlen(fw_version) : 0U;

	if (fw_len > (CLP_MAX_PAYLOAD - CLP_HELLO_FIXED)) {
		fw_len = CLP_MAX_PAYLOAD - CLP_HELLO_FIXED;
	}

	payload[0] = CLP_VERSION;
	sys_put_le16(CLP_MAX_PAYLOAD, &payload[1]);
	if (fw_len > 0U) {
		memcpy(&payload[CLP_HELLO_FIXED], fw_version, fw_len);
	}

	return clp_encode_raw(CLP_MSG_HELLO, seq, payload,
			      (uint16_t)(CLP_HELLO_FIXED + fw_len),
			      out, out_size);
}

/* -------------------------------------------------------------------------- */
/* Decoding helpers                                                           */
/* -------------------------------------------------------------------------- */

int clp_decode_can_frame(const uint8_t *payload, uint16_t len,
			 struct clp_can_frame *out)
{
	uint8_t n;

	if (len < CLP_CANF_FIXED) {
		return -EBADMSG;
	}

	memset(out, 0, sizeof(*out));
	out->can_id = sys_get_le32(&payload[0]);
	out->flags = payload[4];
	out->dlc = payload[5];
	out->tag = sys_get_le16(&payload[6]);
	out->timestamp = sys_get_le64(&payload[8]);

	n = clp_dlc_to_bytes(out->dlc);
	if ((out->flags & CLP_CANF_RTR) != 0U) {
		n = 0U;
	}
	if (len != CLP_CANF_FIXED + n) {
		return -EBADMSG;
	}
	memcpy(out->data, &payload[CLP_CANF_FIXED], n);
	return 0;
}

int clp_decode_tx_ack(const uint8_t *payload, uint16_t len,
		      struct clp_tx_ack *out)
{
	if (len != CLP_TX_ACK_SIZE) {
		return -EBADMSG;
	}
	out->tag = sys_get_le16(&payload[0]);
	out->status = (int16_t)sys_get_le16(&payload[2]);
	out->timestamp = sys_get_le64(&payload[4]);
	return 0;
}

int clp_decode_status(const uint8_t *payload, uint16_t len,
		      struct clp_status *out)
{
	if (len != CLP_STATUS_SIZE) {
		return -EBADMSG;
	}
	out->bus_state = payload[0];
	out->rx_frames = sys_get_le32(&payload[1]);
	out->tx_frames = sys_get_le32(&payload[5]);
	out->rx_drops = sys_get_le32(&payload[9]);
	out->tx_err_cnt = payload[13];
	out->rx_err_cnt = payload[14];
	return 0;
}

/* -------------------------------------------------------------------------- */
/* Streaming parser                                                           */
/* -------------------------------------------------------------------------- */

static void clp_parser_dispatch(struct clp_parser *p)
{
	uint16_t plen;
	uint16_t crc_rx, crc_calc;

	if (p->frame_len == 0U) {
		/* Stray / back-to-back delimiter - not a frame, ignore. */
		return;
	}
	if (p->overflow || p->frame_len < (CLP_HEADER_SIZE + CLP_CRC_SIZE)) {
		p->framing_errors++;
		return;
	}

	plen = sys_get_le16(&p->frame[3]);
	if ((size_t)CLP_HEADER_SIZE + plen + CLP_CRC_SIZE != p->frame_len) {
		p->framing_errors++;
		return;
	}
	if (p->frame[0] != CLP_VERSION) {
		p->framing_errors++;
		return;
	}

	crc_rx = sys_get_le16(&p->frame[CLP_HEADER_SIZE + plen]);
	crc_calc = clp_crc16(p->frame, CLP_HEADER_SIZE + plen);
	if (crc_rx != crc_calc) {
		p->crc_errors++;
		return;
	}

	p->frames_ok++;
	if (p->cb != NULL) {
		p->cb(p->frame[1], p->frame[2], &p->frame[CLP_HEADER_SIZE],
		      plen, p->user_data);
	}
}

/* COBS decoder output sink: accumulate one logical frame, flush on delimiter. */
static int clp_cobs_cb(const uint8_t *buf, size_t len, void *user_data)
{
	struct clp_parser *p = user_data;

	if (buf == NULL) {
		/* Frame delimiter reached. */
		clp_parser_dispatch(p);
		p->frame_len = 0;
		p->overflow = false;
		return 0;
	}

	if (p->frame_len + len > sizeof(p->frame)) {
		/* Too big for any CLP message - keep consuming, drop at end. */
		p->overflow = true;
		return 0;
	}
	memcpy(&p->frame[p->frame_len], buf, len);
	p->frame_len += len;
	return 0;
}

void clp_parser_init(struct clp_parser *p, clp_frame_cb_t cb, void *user_data)
{
	memset(p, 0, sizeof(*p));
	p->cb = cb;
	p->user_data = user_data;
	(void)cobs_decoder_init(&p->dec, clp_cobs_cb, p,
				COBS_FLAG_TRAILING_DELIMITER);
}

int clp_parser_feed(struct clp_parser *p, const uint8_t *buf, size_t len)
{
	/*
	 * Feed one byte at a time: on a COBS structure violation the decoder
	 * resets itself and returns < 0; byte granularity lets us drop exactly
	 * the corrupt run and resync on the very next 0x00 delimiter without
	 * losing the frames that follow it. CDC-ACM data rates make the
	 * per-byte call cost irrelevant.
	 */
	for (size_t i = 0; i < len; i++) {
		int ret = cobs_decoder_write(&p->dec, &buf[i], 1);

		if (ret < 0) {
			p->frame_len = 0;
			p->overflow = false;
			p->framing_errors++;
			/* decoder already reset by cobs_decoder_write() */
		}
	}
	return 0;
}
```

## src/usb_link.c
```c
/*
 * SPDX-License-Identifier: Apache-2.0
 *
 * Phase 2C - CDC-ACM <-> CLP glue. Build-only; nothing is flashed.
 *
 * TX path: usb_link_send_*() encode a COBS-framed CLP frame onto the stack,
 * then push the bytes into tx_rb under a spinlock. The CDC-ACM TX interrupt
 * drains tx_rb into the USB FIFO. Producers may be any context (incl. a CAN
 * RX ISR later), so the buffer is lock-guarded and lossy-by-design: a full
 * buffer drops the frame and bumps a counter rather than blocking.
 *
 * RX path: the CDC-ACM RX interrupt reads the FIFO and feeds clp_parser, which
 * calls on_clp_frame() for each CRC-valid frame. CLP_MSG_CAN_TX is decoded and
 * forwarded to the registered handler.
 */

#include <errno.h>

#include <zephyr/device.h>
#include <zephyr/drivers/uart.h>
#include <zephyr/kernel.h>
#include <zephyr/sys/ring_buffer.h>
#include <zephyr/usb/usbd.h>
#include <zephyr/logging/log.h>

#include "usb_link.h"
#include "usbd_ctx.h"

LOG_MODULE_REGISTER(usb_link, LOG_LEVEL_INF);

#define USB_LINK_FW_VERSION "usb_cdc phase-2c v0.1"

BUILD_ASSERT(DT_HAS_COMPAT_STATUS_OKAY(zephyr_cdc_acm_uart),
	     "no enabled zephyr,cdc-acm-uart node - add one in the app overlay");

static const struct device *const cdc_dev =
	DEVICE_DT_GET_ONE(zephyr_cdc_acm_uart);

#define TX_RING_SIZE 2048
RING_BUF_DECLARE(tx_rb, TX_RING_SIZE);
static struct k_spinlock tx_lock;

#define RX_CHUNK 64

static struct usbd_context *usbd;
static struct clp_parser parser;

static usb_link_tx_request_cb_t tx_req_cb;
static void *tx_req_cb_data;

static atomic_t connected = ATOMIC_INIT(0);
static uint8_t tx_seq;

/* Counters (host-visible via STATUS / usb_link_get_counters). */
static atomic_t stat_tx_frames;
static atomic_t stat_rx_drops;

/* -------------------------------------------------------------------------- */
/* Outbound                                                                   */
/* -------------------------------------------------------------------------- */

static int tx_push(const uint8_t *wire, size_t len)
{
	k_spinlock_key_t key;
	uint32_t wrote;

	if (!atomic_get(&connected)) {
		return -ENOTCONN;
	}

	key = k_spin_lock(&tx_lock);
	if (ring_buf_space_get(&tx_rb) < len) {
		k_spin_unlock(&tx_lock, key);
		atomic_inc(&stat_rx_drops);
		return -ENOSPC;
	}
	wrote = ring_buf_put(&tx_rb, wire, len);
	k_spin_unlock(&tx_lock, key);

	if (wrote != len) {
		atomic_inc(&stat_rx_drops);
		return -ENOSPC;
	}

	uart_irq_tx_enable(cdc_dev);
	return 0;
}

int usb_link_send_can_rx(const struct clp_can_frame *f)
{
	uint8_t wire[CLP_MAX_WIRE];
	int n;

	n = clp_encode_can_frame(CLP_MSG_CAN_RX, tx_seq++, f, wire, sizeof(wire));
	if (n < 0) {
		return n;
	}

	n = tx_push(wire, (size_t)n);
	if (n == 0) {
		atomic_inc(&stat_tx_frames);
	}
	return n;
}

int usb_link_send_tx_ack(const struct clp_tx_ack *ack)
{
	uint8_t wire[CLP_MAX_WIRE];
	int n = clp_encode_tx_ack(tx_seq++, ack, wire, sizeof(wire));

	if (n < 0) {
		return n;
	}
	return tx_push(wire, (size_t)n);
}

int usb_link_send_status(const struct clp_status *st)
{
	uint8_t wire[CLP_MAX_WIRE];
	int n = clp_encode_status(tx_seq++, st, wire, sizeof(wire));

	if (n < 0) {
		return n;
	}
	return tx_push(wire, (size_t)n);
}

static void send_hello(void)
{
	uint8_t wire[CLP_MAX_WIRE];
	int n = clp_encode_hello(tx_seq++, USB_LINK_FW_VERSION,
				 wire, sizeof(wire));

	if (n > 0) {
		(void)tx_push(wire, (size_t)n);
	}
}

/* -------------------------------------------------------------------------- */
/* Inbound - CLP frame dispatch                                               */
/* -------------------------------------------------------------------------- */

static void on_clp_frame(uint8_t type, uint8_t seq, const uint8_t *payload,
			 uint16_t len, void *user_data)
{
	ARG_UNUSED(seq);
	ARG_UNUSED(user_data);

	switch (type) {
	case CLP_MSG_CAN_TX: {
		struct clp_can_frame req;

		if (clp_decode_can_frame(payload, len, &req) != 0) {
			LOG_WRN("CAN_TX decode failed (len %u)", len);
			return;
		}
		if (tx_req_cb != NULL) {
			tx_req_cb(&req, tx_req_cb_data);
		}
		break;
	}
	default:
		LOG_DBG("ignoring inbound CLP type 0x%02x", type);
		break;
	}
}

/* -------------------------------------------------------------------------- */
/* CDC-ACM interrupt handler (RX + TX servicing)                              */
/* -------------------------------------------------------------------------- */

static void cdc_isr(const struct device *dev, void *user_data)
{
	ARG_UNUSED(user_data);

	while (true) {
		uart_irq_update(dev);
		if (uart_irq_is_pending(dev) <= 0) {
			break;
		}

		if (uart_irq_rx_ready(dev)) {
			uint8_t buf[RX_CHUNK];
			int n = uart_fifo_read(dev, buf, sizeof(buf));

			if (n > 0) {
				(void)clp_parser_feed(&parser, buf, (size_t)n);
			}
		}

		if (uart_irq_tx_ready(dev)) {
			uint8_t buf[RX_CHUNK];
			k_spinlock_key_t key = k_spin_lock(&tx_lock);
			uint32_t n = ring_buf_get(&tx_rb, buf, sizeof(buf));

			k_spin_unlock(&tx_lock, key);

			if (n == 0) {
				uart_irq_tx_disable(dev);
			} else {
				int sent = uart_fifo_fill(dev, buf, n);

				if (sent < (int)n) {
					/* Put the tail back for the next IRQ. */
					key = k_spin_lock(&tx_lock);
					ring_buf_put(&tx_rb, &buf[sent],
						     n - (uint32_t)sent);
					k_spin_unlock(&tx_lock, key);
				}
			}
		}
	}
}

/* -------------------------------------------------------------------------- */
/* USB device message callback                                                */
/* -------------------------------------------------------------------------- */

static void usbd_msg_cb(struct usbd_context *const ctx, const struct usbd_msg *msg)
{
	if (usbd_can_detect_vbus(ctx)) {
		if (msg->type == USBD_MSG_VBUS_READY) {
			if (usbd_enable(ctx)) {
				LOG_ERR("usbd_enable failed");
			}
		} else if (msg->type == USBD_MSG_VBUS_REMOVED) {
			(void)usbd_disable(ctx);
		}
	}

	if (msg->type == USBD_MSG_CDC_ACM_CONTROL_LINE_STATE) {
		uint32_t dtr = 0U;

		(void)uart_line_ctrl_get(msg->dev, UART_LINE_CTRL_DTR, &dtr);
		if (dtr && atomic_set(&connected, 1) == 0) {
			LOG_INF("host connected (DTR) - sending HELLO");
			send_hello();
			uart_irq_rx_enable(cdc_dev);
		} else if (!dtr) {
			atomic_set(&connected, 0);
		}
	}
}

/* -------------------------------------------------------------------------- */
/* Public                                                                     */
/* -------------------------------------------------------------------------- */

void usb_link_set_tx_handler(usb_link_tx_request_cb_t cb, void *user_data)
{
	tx_req_cb = cb;
	tx_req_cb_data = user_data;
}

bool usb_link_connected(void)
{
	return atomic_get(&connected) != 0;
}

void usb_link_get_counters(uint32_t *tx_frames, uint32_t *rx_drops,
			   uint32_t *crc_errors, uint32_t *framing_errors)
{
	if (tx_frames != NULL) {
		*tx_frames = (uint32_t)atomic_get(&stat_tx_frames);
	}
	if (rx_drops != NULL) {
		*rx_drops = (uint32_t)atomic_get(&stat_rx_drops);
	}
	if (crc_errors != NULL) {
		*crc_errors = parser.crc_errors;
	}
	if (framing_errors != NULL) {
		*framing_errors = parser.framing_errors;
	}
}

int usb_link_init(void)
{
	int err;

	if (!device_is_ready(cdc_dev)) {
		LOG_ERR("CDC-ACM device not ready");
		return -ENODEV;
	}

	clp_parser_init(&parser, on_clp_frame, NULL);

	usbd = usb_cdc_init_usbd(usbd_msg_cb);
	if (usbd == NULL) {
		return -ENODEV;
	}

	uart_irq_rx_disable(cdc_dev);
	uart_irq_tx_disable(cdc_dev);
	uart_irq_callback_set(cdc_dev, cdc_isr);

	if (!usbd_can_detect_vbus(usbd)) {
		err = usbd_enable(usbd);
		if (err) {
			LOG_ERR("usbd_enable failed: %d", err);
			return err;
		}
	}

	LOG_INF("USB CDC-ACM up; waiting for host");
	return 0;
}
```

## src/usbd_ctx.c
```c
/*
 * SPDX-License-Identifier: Apache-2.0
 *
 * Phase 2C - USB device context. Build-only; no board attached.
 *
 * Templated from zephyr/samples/subsys/usb/common/sample_usbd_init.c.
 *
 * VID/PID: the Zephyr project test values (VID 0x2fe3 / PID 0x0001).
 * PLACEHOLDER - must be replaced with an allocated VID/PID before this
 * firmware is distributed outside the bench.
 */

#include <zephyr/device.h>
#include <zephyr/usb/usbd.h>
#include <zephyr/logging/log.h>

#include "usbd_ctx.h"

LOG_MODULE_REGISTER(usbd_ctx, LOG_LEVEL_INF);

#define USB_CDC_VID          0x2fe3   /* PLACEHOLDER - Zephyr project test VID */
#define USB_CDC_PID          0x0001   /* PLACEHOLDER                          */
#define USB_CDC_MANUFACTURER "BITS WILP ESD"
#define USB_CDC_PRODUCT      "EK-RA8D1 CAN Logger"
#define USB_CDC_MAX_POWER    125      /* in 2 mA units => 250 mA             */

USBD_DEVICE_DEFINE(usb_cdc_usbd,
		   DEVICE_DT_GET(DT_NODELABEL(zephyr_udc0)),
		   USB_CDC_VID, USB_CDC_PID);

USBD_DESC_LANG_DEFINE(usb_cdc_lang);
USBD_DESC_MANUFACTURER_DEFINE(usb_cdc_mfr, USB_CDC_MANUFACTURER);
USBD_DESC_PRODUCT_DEFINE(usb_cdc_prod, USB_CDC_PRODUCT);
IF_ENABLED(CONFIG_HWINFO, (USBD_DESC_SERIAL_NUMBER_DEFINE(usb_cdc_sn)));

USBD_DESC_CONFIG_DEFINE(usb_cdc_fs_desc, "CLP FS Configuration");
USBD_DESC_CONFIG_DEFINE(usb_cdc_hs_desc, "CLP HS Configuration");

static const uint8_t usb_cdc_attributes = USB_SCD_SELF_POWERED;

USBD_CONFIGURATION_DEFINE(usb_cdc_fs_config, usb_cdc_attributes,
			  USB_CDC_MAX_POWER, &usb_cdc_fs_desc);
USBD_CONFIGURATION_DEFINE(usb_cdc_hs_config, usb_cdc_attributes,
			  USB_CDC_MAX_POWER, &usb_cdc_hs_desc);

/* Do not register the USB DFU class DFU-mode instance. */
static const char *const usb_cdc_blocklist[] = { "dfu_dfu", NULL };

/*
 * CDC-ACM presents multiple interfaces and carries an Interface Association
 * Descriptor, so the device-level class triple must advertise MISC/0x02/0x01
 * (same rule the sample applies).
 */
static void usb_cdc_fix_code_triple(struct usbd_context *ctx, enum usbd_speed speed)
{
	if (IS_ENABLED(CONFIG_USBD_CDC_ACM_CLASS)) {
		usbd_device_set_code_triple(ctx, speed,
					    USB_BCC_MISCELLANEOUS, 0x02, 0x01);
	} else {
		usbd_device_set_code_triple(ctx, speed, 0, 0, 0);
	}
}

static int usb_cdc_add_descriptors(void)
{
	int err;

	err = usbd_add_descriptor(&usb_cdc_usbd, &usb_cdc_lang);
	if (err == 0) {
		err = usbd_add_descriptor(&usb_cdc_usbd, &usb_cdc_mfr);
	}
	if (err == 0) {
		err = usbd_add_descriptor(&usb_cdc_usbd, &usb_cdc_prod);
	}
	IF_ENABLED(CONFIG_HWINFO, (
		if (err == 0) {
			err = usbd_add_descriptor(&usb_cdc_usbd, &usb_cdc_sn);
		}
	))
	return err;
}

static int usb_cdc_add_speed_config(enum usbd_speed speed,
				    struct usbd_config_node *config)
{
	int err;

	err = usbd_add_configuration(&usb_cdc_usbd, speed, config);
	if (err) {
		LOG_ERR("add configuration (speed %d) failed: %d", speed, err);
		return err;
	}

	err = usbd_register_all_classes(&usb_cdc_usbd, speed, 1,
				       usb_cdc_blocklist);
	if (err) {
		LOG_ERR("register classes (speed %d) failed: %d", speed, err);
		return err;
	}

	usb_cdc_fix_code_triple(&usb_cdc_usbd, speed);
	return 0;
}

struct usbd_context *usb_cdc_init_usbd(usbd_msg_cb_t msg_cb)
{
	int err;

	err = usb_cdc_add_descriptors();
	if (err) {
		LOG_ERR("add descriptors failed: %d", err);
		return NULL;
	}

	if (USBD_SUPPORTS_HIGH_SPEED &&
	    usbd_caps_speed(&usb_cdc_usbd) == USBD_SPEED_HS) {
		if (usb_cdc_add_speed_config(USBD_SPEED_HS,
					    &usb_cdc_hs_config) != 0) {
			return NULL;
		}
	}

	if (usb_cdc_add_speed_config(USBD_SPEED_FS, &usb_cdc_fs_config) != 0) {
		return NULL;
	}

	usbd_self_powered(&usb_cdc_usbd,
			  usb_cdc_attributes & USB_SCD_SELF_POWERED);

	if (msg_cb != NULL) {
		err = usbd_msg_register_cb(&usb_cdc_usbd, msg_cb);
		if (err) {
			LOG_ERR("msg cb register failed: %d", err);
			return NULL;
		}
	}

	err = usbd_init(&usb_cdc_usbd);
	if (err) {
		LOG_ERR("usbd_init failed: %d", err);
		return NULL;
	}

	return &usb_cdc_usbd;
}
```
